/*******************************************************************************
* File Name: cyfittergnu.inc
* 
* PSoC Creator  4.3
*
* Description:
* 
* This file is automatically generated by PSoC Creator.
*
********************************************************************************
* Copyright (c) 2007-2019 Cypress Semiconductor.  All rights reserved.
* You may use this file only in accordance with the license, terms, conditions, 
* disclaimers, and limitations in the end user license agreement accompanying 
* the software package with which this file was provided.
********************************************************************************/

.ifndef INCLUDED_CYFITTERGNU_INC
.set INCLUDED_CYFITTERGNU_INC, 1
.include "cydevicegnu_trm.inc"

/* E */
.set E__0__DM__MASK, 0x38000
.set E__0__DM__SHIFT, 15
.set E__0__DR, CYREG_PRT1_DR
.set E__0__HSIOM, CYREG_HSIOM_PORT_SEL1
.set E__0__HSIOM_MASK, 0x00F00000
.set E__0__HSIOM_SHIFT, 20
.set E__0__INTCFG, CYREG_PRT1_INTCFG
.set E__0__INTSTAT, CYREG_PRT1_INTSTAT
.set E__0__MASK, 0x20
.set E__0__PA__CFG0, CYREG_UDB_PA1_CFG0
.set E__0__PA__CFG1, CYREG_UDB_PA1_CFG1
.set E__0__PA__CFG10, CYREG_UDB_PA1_CFG10
.set E__0__PA__CFG11, CYREG_UDB_PA1_CFG11
.set E__0__PA__CFG12, CYREG_UDB_PA1_CFG12
.set E__0__PA__CFG13, CYREG_UDB_PA1_CFG13
.set E__0__PA__CFG14, CYREG_UDB_PA1_CFG14
.set E__0__PA__CFG2, CYREG_UDB_PA1_CFG2
.set E__0__PA__CFG3, CYREG_UDB_PA1_CFG3
.set E__0__PA__CFG4, CYREG_UDB_PA1_CFG4
.set E__0__PA__CFG5, CYREG_UDB_PA1_CFG5
.set E__0__PA__CFG6, CYREG_UDB_PA1_CFG6
.set E__0__PA__CFG7, CYREG_UDB_PA1_CFG7
.set E__0__PA__CFG8, CYREG_UDB_PA1_CFG8
.set E__0__PA__CFG9, CYREG_UDB_PA1_CFG9
.set E__0__PC, CYREG_PRT1_PC
.set E__0__PC2, CYREG_PRT1_PC2
.set E__0__PORT, 1
.set E__0__PS, CYREG_PRT1_PS
.set E__0__SHIFT, 5
.set E__DR, CYREG_PRT1_DR
.set E__INTCFG, CYREG_PRT1_INTCFG
.set E__INTSTAT, CYREG_PRT1_INTSTAT
.set E__MASK, 0x20
.set E__PA__CFG0, CYREG_UDB_PA1_CFG0
.set E__PA__CFG1, CYREG_UDB_PA1_CFG1
.set E__PA__CFG10, CYREG_UDB_PA1_CFG10
.set E__PA__CFG11, CYREG_UDB_PA1_CFG11
.set E__PA__CFG12, CYREG_UDB_PA1_CFG12
.set E__PA__CFG13, CYREG_UDB_PA1_CFG13
.set E__PA__CFG14, CYREG_UDB_PA1_CFG14
.set E__PA__CFG2, CYREG_UDB_PA1_CFG2
.set E__PA__CFG3, CYREG_UDB_PA1_CFG3
.set E__PA__CFG4, CYREG_UDB_PA1_CFG4
.set E__PA__CFG5, CYREG_UDB_PA1_CFG5
.set E__PA__CFG6, CYREG_UDB_PA1_CFG6
.set E__PA__CFG7, CYREG_UDB_PA1_CFG7
.set E__PA__CFG8, CYREG_UDB_PA1_CFG8
.set E__PA__CFG9, CYREG_UDB_PA1_CFG9
.set E__PC, CYREG_PRT1_PC
.set E__PC2, CYREG_PRT1_PC2
.set E__PORT, 1
.set E__PS, CYREG_PRT1_PS
.set E__SHIFT, 5

/* A0 */
.set A0__0__DM__MASK, 0x7000
.set A0__0__DM__SHIFT, 12
.set A0__0__DR, CYREG_PRT1_DR
.set A0__0__HSIOM, CYREG_HSIOM_PORT_SEL1
.set A0__0__HSIOM_MASK, 0x000F0000
.set A0__0__HSIOM_SHIFT, 16
.set A0__0__INTCFG, CYREG_PRT1_INTCFG
.set A0__0__INTSTAT, CYREG_PRT1_INTSTAT
.set A0__0__MASK, 0x10
.set A0__0__PA__CFG0, CYREG_UDB_PA1_CFG0
.set A0__0__PA__CFG1, CYREG_UDB_PA1_CFG1
.set A0__0__PA__CFG10, CYREG_UDB_PA1_CFG10
.set A0__0__PA__CFG11, CYREG_UDB_PA1_CFG11
.set A0__0__PA__CFG12, CYREG_UDB_PA1_CFG12
.set A0__0__PA__CFG13, CYREG_UDB_PA1_CFG13
.set A0__0__PA__CFG14, CYREG_UDB_PA1_CFG14
.set A0__0__PA__CFG2, CYREG_UDB_PA1_CFG2
.set A0__0__PA__CFG3, CYREG_UDB_PA1_CFG3
.set A0__0__PA__CFG4, CYREG_UDB_PA1_CFG4
.set A0__0__PA__CFG5, CYREG_UDB_PA1_CFG5
.set A0__0__PA__CFG6, CYREG_UDB_PA1_CFG6
.set A0__0__PA__CFG7, CYREG_UDB_PA1_CFG7
.set A0__0__PA__CFG8, CYREG_UDB_PA1_CFG8
.set A0__0__PA__CFG9, CYREG_UDB_PA1_CFG9
.set A0__0__PC, CYREG_PRT1_PC
.set A0__0__PC2, CYREG_PRT1_PC2
.set A0__0__PORT, 1
.set A0__0__PS, CYREG_PRT1_PS
.set A0__0__SHIFT, 4
.set A0__DR, CYREG_PRT1_DR
.set A0__INTCFG, CYREG_PRT1_INTCFG
.set A0__INTSTAT, CYREG_PRT1_INTSTAT
.set A0__MASK, 0x10
.set A0__PA__CFG0, CYREG_UDB_PA1_CFG0
.set A0__PA__CFG1, CYREG_UDB_PA1_CFG1
.set A0__PA__CFG10, CYREG_UDB_PA1_CFG10
.set A0__PA__CFG11, CYREG_UDB_PA1_CFG11
.set A0__PA__CFG12, CYREG_UDB_PA1_CFG12
.set A0__PA__CFG13, CYREG_UDB_PA1_CFG13
.set A0__PA__CFG14, CYREG_UDB_PA1_CFG14
.set A0__PA__CFG2, CYREG_UDB_PA1_CFG2
.set A0__PA__CFG3, CYREG_UDB_PA1_CFG3
.set A0__PA__CFG4, CYREG_UDB_PA1_CFG4
.set A0__PA__CFG5, CYREG_UDB_PA1_CFG5
.set A0__PA__CFG6, CYREG_UDB_PA1_CFG6
.set A0__PA__CFG7, CYREG_UDB_PA1_CFG7
.set A0__PA__CFG8, CYREG_UDB_PA1_CFG8
.set A0__PA__CFG9, CYREG_UDB_PA1_CFG9
.set A0__PC, CYREG_PRT1_PC
.set A0__PC2, CYREG_PRT1_PC2
.set A0__PORT, 1
.set A0__PS, CYREG_PRT1_PS
.set A0__SHIFT, 4

/* CS */
.set CS__0__DM__MASK, 0x1C0
.set CS__0__DM__SHIFT, 6
.set CS__0__DR, CYREG_PRT1_DR
.set CS__0__HSIOM, CYREG_HSIOM_PORT_SEL1
.set CS__0__HSIOM_MASK, 0x00000F00
.set CS__0__HSIOM_SHIFT, 8
.set CS__0__INTCFG, CYREG_PRT1_INTCFG
.set CS__0__INTSTAT, CYREG_PRT1_INTSTAT
.set CS__0__MASK, 0x04
.set CS__0__PA__CFG0, CYREG_UDB_PA1_CFG0
.set CS__0__PA__CFG1, CYREG_UDB_PA1_CFG1
.set CS__0__PA__CFG10, CYREG_UDB_PA1_CFG10
.set CS__0__PA__CFG11, CYREG_UDB_PA1_CFG11
.set CS__0__PA__CFG12, CYREG_UDB_PA1_CFG12
.set CS__0__PA__CFG13, CYREG_UDB_PA1_CFG13
.set CS__0__PA__CFG14, CYREG_UDB_PA1_CFG14
.set CS__0__PA__CFG2, CYREG_UDB_PA1_CFG2
.set CS__0__PA__CFG3, CYREG_UDB_PA1_CFG3
.set CS__0__PA__CFG4, CYREG_UDB_PA1_CFG4
.set CS__0__PA__CFG5, CYREG_UDB_PA1_CFG5
.set CS__0__PA__CFG6, CYREG_UDB_PA1_CFG6
.set CS__0__PA__CFG7, CYREG_UDB_PA1_CFG7
.set CS__0__PA__CFG8, CYREG_UDB_PA1_CFG8
.set CS__0__PA__CFG9, CYREG_UDB_PA1_CFG9
.set CS__0__PC, CYREG_PRT1_PC
.set CS__0__PC2, CYREG_PRT1_PC2
.set CS__0__PORT, 1
.set CS__0__PS, CYREG_PRT1_PS
.set CS__0__SHIFT, 2
.set CS__DR, CYREG_PRT1_DR
.set CS__INTCFG, CYREG_PRT1_INTCFG
.set CS__INTSTAT, CYREG_PRT1_INTSTAT
.set CS__MASK, 0x04
.set CS__PA__CFG0, CYREG_UDB_PA1_CFG0
.set CS__PA__CFG1, CYREG_UDB_PA1_CFG1
.set CS__PA__CFG10, CYREG_UDB_PA1_CFG10
.set CS__PA__CFG11, CYREG_UDB_PA1_CFG11
.set CS__PA__CFG12, CYREG_UDB_PA1_CFG12
.set CS__PA__CFG13, CYREG_UDB_PA1_CFG13
.set CS__PA__CFG14, CYREG_UDB_PA1_CFG14
.set CS__PA__CFG2, CYREG_UDB_PA1_CFG2
.set CS__PA__CFG3, CYREG_UDB_PA1_CFG3
.set CS__PA__CFG4, CYREG_UDB_PA1_CFG4
.set CS__PA__CFG5, CYREG_UDB_PA1_CFG5
.set CS__PA__CFG6, CYREG_UDB_PA1_CFG6
.set CS__PA__CFG7, CYREG_UDB_PA1_CFG7
.set CS__PA__CFG8, CYREG_UDB_PA1_CFG8
.set CS__PA__CFG9, CYREG_UDB_PA1_CFG9
.set CS__PC, CYREG_PRT1_PC
.set CS__PC2, CYREG_PRT1_PC2
.set CS__PORT, 1
.set CS__PS, CYREG_PRT1_PS
.set CS__SHIFT, 2

/* RESET */
.set RESET__0__DM__MASK, 0xE00
.set RESET__0__DM__SHIFT, 9
.set RESET__0__DR, CYREG_PRT1_DR
.set RESET__0__HSIOM, CYREG_HSIOM_PORT_SEL1
.set RESET__0__HSIOM_MASK, 0x0000F000
.set RESET__0__HSIOM_SHIFT, 12
.set RESET__0__INTCFG, CYREG_PRT1_INTCFG
.set RESET__0__INTSTAT, CYREG_PRT1_INTSTAT
.set RESET__0__MASK, 0x08
.set RESET__0__PA__CFG0, CYREG_UDB_PA1_CFG0
.set RESET__0__PA__CFG1, CYREG_UDB_PA1_CFG1
.set RESET__0__PA__CFG10, CYREG_UDB_PA1_CFG10
.set RESET__0__PA__CFG11, CYREG_UDB_PA1_CFG11
.set RESET__0__PA__CFG12, CYREG_UDB_PA1_CFG12
.set RESET__0__PA__CFG13, CYREG_UDB_PA1_CFG13
.set RESET__0__PA__CFG14, CYREG_UDB_PA1_CFG14
.set RESET__0__PA__CFG2, CYREG_UDB_PA1_CFG2
.set RESET__0__PA__CFG3, CYREG_UDB_PA1_CFG3
.set RESET__0__PA__CFG4, CYREG_UDB_PA1_CFG4
.set RESET__0__PA__CFG5, CYREG_UDB_PA1_CFG5
.set RESET__0__PA__CFG6, CYREG_UDB_PA1_CFG6
.set RESET__0__PA__CFG7, CYREG_UDB_PA1_CFG7
.set RESET__0__PA__CFG8, CYREG_UDB_PA1_CFG8
.set RESET__0__PA__CFG9, CYREG_UDB_PA1_CFG9
.set RESET__0__PC, CYREG_PRT1_PC
.set RESET__0__PC2, CYREG_PRT1_PC2
.set RESET__0__PORT, 1
.set RESET__0__PS, CYREG_PRT1_PS
.set RESET__0__SHIFT, 3
.set RESET__DR, CYREG_PRT1_DR
.set RESET__INTCFG, CYREG_PRT1_INTCFG
.set RESET__INTSTAT, CYREG_PRT1_INTSTAT
.set RESET__MASK, 0x08
.set RESET__PA__CFG0, CYREG_UDB_PA1_CFG0
.set RESET__PA__CFG1, CYREG_UDB_PA1_CFG1
.set RESET__PA__CFG10, CYREG_UDB_PA1_CFG10
.set RESET__PA__CFG11, CYREG_UDB_PA1_CFG11
.set RESET__PA__CFG12, CYREG_UDB_PA1_CFG12
.set RESET__PA__CFG13, CYREG_UDB_PA1_CFG13
.set RESET__PA__CFG14, CYREG_UDB_PA1_CFG14
.set RESET__PA__CFG2, CYREG_UDB_PA1_CFG2
.set RESET__PA__CFG3, CYREG_UDB_PA1_CFG3
.set RESET__PA__CFG4, CYREG_UDB_PA1_CFG4
.set RESET__PA__CFG5, CYREG_UDB_PA1_CFG5
.set RESET__PA__CFG6, CYREG_UDB_PA1_CFG6
.set RESET__PA__CFG7, CYREG_UDB_PA1_CFG7
.set RESET__PA__CFG8, CYREG_UDB_PA1_CFG8
.set RESET__PA__CFG9, CYREG_UDB_PA1_CFG9
.set RESET__PC, CYREG_PRT1_PC
.set RESET__PC2, CYREG_PRT1_PC2
.set RESET__PORT, 1
.set RESET__PS, CYREG_PRT1_PS
.set RESET__SHIFT, 3

/* LCD_CD */
.set LCD_CD__0__DM__MASK, 0xE00000
.set LCD_CD__0__DM__SHIFT, 21
.set LCD_CD__0__DR, CYREG_PRT3_DR
.set LCD_CD__0__HSIOM, CYREG_HSIOM_PORT_SEL3
.set LCD_CD__0__HSIOM_MASK, 0xF0000000
.set LCD_CD__0__HSIOM_SHIFT, 28
.set LCD_CD__0__INTCFG, CYREG_PRT3_INTCFG
.set LCD_CD__0__INTSTAT, CYREG_PRT3_INTSTAT
.set LCD_CD__0__MASK, 0x80
.set LCD_CD__0__PA__CFG0, CYREG_UDB_PA3_CFG0
.set LCD_CD__0__PA__CFG1, CYREG_UDB_PA3_CFG1
.set LCD_CD__0__PA__CFG10, CYREG_UDB_PA3_CFG10
.set LCD_CD__0__PA__CFG11, CYREG_UDB_PA3_CFG11
.set LCD_CD__0__PA__CFG12, CYREG_UDB_PA3_CFG12
.set LCD_CD__0__PA__CFG13, CYREG_UDB_PA3_CFG13
.set LCD_CD__0__PA__CFG14, CYREG_UDB_PA3_CFG14
.set LCD_CD__0__PA__CFG2, CYREG_UDB_PA3_CFG2
.set LCD_CD__0__PA__CFG3, CYREG_UDB_PA3_CFG3
.set LCD_CD__0__PA__CFG4, CYREG_UDB_PA3_CFG4
.set LCD_CD__0__PA__CFG5, CYREG_UDB_PA3_CFG5
.set LCD_CD__0__PA__CFG6, CYREG_UDB_PA3_CFG6
.set LCD_CD__0__PA__CFG7, CYREG_UDB_PA3_CFG7
.set LCD_CD__0__PA__CFG8, CYREG_UDB_PA3_CFG8
.set LCD_CD__0__PA__CFG9, CYREG_UDB_PA3_CFG9
.set LCD_CD__0__PC, CYREG_PRT3_PC
.set LCD_CD__0__PC2, CYREG_PRT3_PC2
.set LCD_CD__0__PORT, 3
.set LCD_CD__0__PS, CYREG_PRT3_PS
.set LCD_CD__0__SHIFT, 7
.set LCD_CD__DR, CYREG_PRT3_DR
.set LCD_CD__INTCFG, CYREG_PRT3_INTCFG
.set LCD_CD__INTSTAT, CYREG_PRT3_INTSTAT
.set LCD_CD__MASK, 0x80
.set LCD_CD__PA__CFG0, CYREG_UDB_PA3_CFG0
.set LCD_CD__PA__CFG1, CYREG_UDB_PA3_CFG1
.set LCD_CD__PA__CFG10, CYREG_UDB_PA3_CFG10
.set LCD_CD__PA__CFG11, CYREG_UDB_PA3_CFG11
.set LCD_CD__PA__CFG12, CYREG_UDB_PA3_CFG12
.set LCD_CD__PA__CFG13, CYREG_UDB_PA3_CFG13
.set LCD_CD__PA__CFG14, CYREG_UDB_PA3_CFG14
.set LCD_CD__PA__CFG2, CYREG_UDB_PA3_CFG2
.set LCD_CD__PA__CFG3, CYREG_UDB_PA3_CFG3
.set LCD_CD__PA__CFG4, CYREG_UDB_PA3_CFG4
.set LCD_CD__PA__CFG5, CYREG_UDB_PA3_CFG5
.set LCD_CD__PA__CFG6, CYREG_UDB_PA3_CFG6
.set LCD_CD__PA__CFG7, CYREG_UDB_PA3_CFG7
.set LCD_CD__PA__CFG8, CYREG_UDB_PA3_CFG8
.set LCD_CD__PA__CFG9, CYREG_UDB_PA3_CFG9
.set LCD_CD__PC, CYREG_PRT3_PC
.set LCD_CD__PC2, CYREG_PRT3_PC2
.set LCD_CD__PORT, 3
.set LCD_CD__PS, CYREG_PRT3_PS
.set LCD_CD__SHIFT, 7

/* SPILCD */
.set SPILCD_mosi_m__0__DM__MASK, 0x7000
.set SPILCD_mosi_m__0__DM__SHIFT, 12
.set SPILCD_mosi_m__0__DR, CYREG_PRT0_DR
.set SPILCD_mosi_m__0__HSIOM, CYREG_HSIOM_PORT_SEL0
.set SPILCD_mosi_m__0__HSIOM_GPIO, 0
.set SPILCD_mosi_m__0__HSIOM_I2C, 14
.set SPILCD_mosi_m__0__HSIOM_I2C_SCL, 14
.set SPILCD_mosi_m__0__HSIOM_MASK, 0x000F0000
.set SPILCD_mosi_m__0__HSIOM_SHIFT, 16
.set SPILCD_mosi_m__0__HSIOM_SPI, 15
.set SPILCD_mosi_m__0__HSIOM_SPI_MOSI, 15
.set SPILCD_mosi_m__0__HSIOM_UART, 9
.set SPILCD_mosi_m__0__HSIOM_UART_RX, 9
.set SPILCD_mosi_m__0__INTCFG, CYREG_PRT0_INTCFG
.set SPILCD_mosi_m__0__INTSTAT, CYREG_PRT0_INTSTAT
.set SPILCD_mosi_m__0__MASK, 0x10
.set SPILCD_mosi_m__0__OUT_SEL, CYREG_UDB_PA0_CFG10
.set SPILCD_mosi_m__0__OUT_SEL_SHIFT, 8
.set SPILCD_mosi_m__0__OUT_SEL_VAL, -1
.set SPILCD_mosi_m__0__PA__CFG0, CYREG_UDB_PA0_CFG0
.set SPILCD_mosi_m__0__PA__CFG1, CYREG_UDB_PA0_CFG1
.set SPILCD_mosi_m__0__PA__CFG10, CYREG_UDB_PA0_CFG10
.set SPILCD_mosi_m__0__PA__CFG11, CYREG_UDB_PA0_CFG11
.set SPILCD_mosi_m__0__PA__CFG12, CYREG_UDB_PA0_CFG12
.set SPILCD_mosi_m__0__PA__CFG13, CYREG_UDB_PA0_CFG13
.set SPILCD_mosi_m__0__PA__CFG14, CYREG_UDB_PA0_CFG14
.set SPILCD_mosi_m__0__PA__CFG2, CYREG_UDB_PA0_CFG2
.set SPILCD_mosi_m__0__PA__CFG3, CYREG_UDB_PA0_CFG3
.set SPILCD_mosi_m__0__PA__CFG4, CYREG_UDB_PA0_CFG4
.set SPILCD_mosi_m__0__PA__CFG5, CYREG_UDB_PA0_CFG5
.set SPILCD_mosi_m__0__PA__CFG6, CYREG_UDB_PA0_CFG6
.set SPILCD_mosi_m__0__PA__CFG7, CYREG_UDB_PA0_CFG7
.set SPILCD_mosi_m__0__PA__CFG8, CYREG_UDB_PA0_CFG8
.set SPILCD_mosi_m__0__PA__CFG9, CYREG_UDB_PA0_CFG9
.set SPILCD_mosi_m__0__PC, CYREG_PRT0_PC
.set SPILCD_mosi_m__0__PC2, CYREG_PRT0_PC2
.set SPILCD_mosi_m__0__PORT, 0
.set SPILCD_mosi_m__0__PS, CYREG_PRT0_PS
.set SPILCD_mosi_m__0__SHIFT, 4
.set SPILCD_mosi_m__DR, CYREG_PRT0_DR
.set SPILCD_mosi_m__INTCFG, CYREG_PRT0_INTCFG
.set SPILCD_mosi_m__INTSTAT, CYREG_PRT0_INTSTAT
.set SPILCD_mosi_m__MASK, 0x10
.set SPILCD_mosi_m__PA__CFG0, CYREG_UDB_PA0_CFG0
.set SPILCD_mosi_m__PA__CFG1, CYREG_UDB_PA0_CFG1
.set SPILCD_mosi_m__PA__CFG10, CYREG_UDB_PA0_CFG10
.set SPILCD_mosi_m__PA__CFG11, CYREG_UDB_PA0_CFG11
.set SPILCD_mosi_m__PA__CFG12, CYREG_UDB_PA0_CFG12
.set SPILCD_mosi_m__PA__CFG13, CYREG_UDB_PA0_CFG13
.set SPILCD_mosi_m__PA__CFG14, CYREG_UDB_PA0_CFG14
.set SPILCD_mosi_m__PA__CFG2, CYREG_UDB_PA0_CFG2
.set SPILCD_mosi_m__PA__CFG3, CYREG_UDB_PA0_CFG3
.set SPILCD_mosi_m__PA__CFG4, CYREG_UDB_PA0_CFG4
.set SPILCD_mosi_m__PA__CFG5, CYREG_UDB_PA0_CFG5
.set SPILCD_mosi_m__PA__CFG6, CYREG_UDB_PA0_CFG6
.set SPILCD_mosi_m__PA__CFG7, CYREG_UDB_PA0_CFG7
.set SPILCD_mosi_m__PA__CFG8, CYREG_UDB_PA0_CFG8
.set SPILCD_mosi_m__PA__CFG9, CYREG_UDB_PA0_CFG9
.set SPILCD_mosi_m__PC, CYREG_PRT0_PC
.set SPILCD_mosi_m__PC2, CYREG_PRT0_PC2
.set SPILCD_mosi_m__PORT, 0
.set SPILCD_mosi_m__PS, CYREG_PRT0_PS
.set SPILCD_mosi_m__SHIFT, 4
.set SPILCD_SCB__BIST_CONTROL, CYREG_SCB1_BIST_CONTROL
.set SPILCD_SCB__BIST_DATA, CYREG_SCB1_BIST_DATA
.set SPILCD_SCB__CTRL, CYREG_SCB1_CTRL
.set SPILCD_SCB__EZ_DATA00, CYREG_SCB1_EZ_DATA00
.set SPILCD_SCB__EZ_DATA01, CYREG_SCB1_EZ_DATA01
.set SPILCD_SCB__EZ_DATA02, CYREG_SCB1_EZ_DATA02
.set SPILCD_SCB__EZ_DATA03, CYREG_SCB1_EZ_DATA03
.set SPILCD_SCB__EZ_DATA04, CYREG_SCB1_EZ_DATA04
.set SPILCD_SCB__EZ_DATA05, CYREG_SCB1_EZ_DATA05
.set SPILCD_SCB__EZ_DATA06, CYREG_SCB1_EZ_DATA06
.set SPILCD_SCB__EZ_DATA07, CYREG_SCB1_EZ_DATA07
.set SPILCD_SCB__EZ_DATA08, CYREG_SCB1_EZ_DATA08
.set SPILCD_SCB__EZ_DATA09, CYREG_SCB1_EZ_DATA09
.set SPILCD_SCB__EZ_DATA10, CYREG_SCB1_EZ_DATA10
.set SPILCD_SCB__EZ_DATA11, CYREG_SCB1_EZ_DATA11
.set SPILCD_SCB__EZ_DATA12, CYREG_SCB1_EZ_DATA12
.set SPILCD_SCB__EZ_DATA13, CYREG_SCB1_EZ_DATA13
.set SPILCD_SCB__EZ_DATA14, CYREG_SCB1_EZ_DATA14
.set SPILCD_SCB__EZ_DATA15, CYREG_SCB1_EZ_DATA15
.set SPILCD_SCB__EZ_DATA16, CYREG_SCB1_EZ_DATA16
.set SPILCD_SCB__EZ_DATA17, CYREG_SCB1_EZ_DATA17
.set SPILCD_SCB__EZ_DATA18, CYREG_SCB1_EZ_DATA18
.set SPILCD_SCB__EZ_DATA19, CYREG_SCB1_EZ_DATA19
.set SPILCD_SCB__EZ_DATA20, CYREG_SCB1_EZ_DATA20
.set SPILCD_SCB__EZ_DATA21, CYREG_SCB1_EZ_DATA21
.set SPILCD_SCB__EZ_DATA22, CYREG_SCB1_EZ_DATA22
.set SPILCD_SCB__EZ_DATA23, CYREG_SCB1_EZ_DATA23
.set SPILCD_SCB__EZ_DATA24, CYREG_SCB1_EZ_DATA24
.set SPILCD_SCB__EZ_DATA25, CYREG_SCB1_EZ_DATA25
.set SPILCD_SCB__EZ_DATA26, CYREG_SCB1_EZ_DATA26
.set SPILCD_SCB__EZ_DATA27, CYREG_SCB1_EZ_DATA27
.set SPILCD_SCB__EZ_DATA28, CYREG_SCB1_EZ_DATA28
.set SPILCD_SCB__EZ_DATA29, CYREG_SCB1_EZ_DATA29
.set SPILCD_SCB__EZ_DATA30, CYREG_SCB1_EZ_DATA30
.set SPILCD_SCB__EZ_DATA31, CYREG_SCB1_EZ_DATA31
.set SPILCD_SCB__I2C_CFG, CYREG_SCB1_I2C_CFG
.set SPILCD_SCB__I2C_CTRL, CYREG_SCB1_I2C_CTRL
.set SPILCD_SCB__I2C_M_CMD, CYREG_SCB1_I2C_M_CMD
.set SPILCD_SCB__I2C_S_CMD, CYREG_SCB1_I2C_S_CMD
.set SPILCD_SCB__I2C_STATUS, CYREG_SCB1_I2C_STATUS
.set SPILCD_SCB__INTR_CAUSE, CYREG_SCB1_INTR_CAUSE
.set SPILCD_SCB__INTR_I2C_EC, CYREG_SCB1_INTR_I2C_EC
.set SPILCD_SCB__INTR_I2C_EC_MASK, CYREG_SCB1_INTR_I2C_EC_MASK
.set SPILCD_SCB__INTR_I2C_EC_MASKED, CYREG_SCB1_INTR_I2C_EC_MASKED
.set SPILCD_SCB__INTR_M, CYREG_SCB1_INTR_M
.set SPILCD_SCB__INTR_M_MASK, CYREG_SCB1_INTR_M_MASK
.set SPILCD_SCB__INTR_M_MASKED, CYREG_SCB1_INTR_M_MASKED
.set SPILCD_SCB__INTR_M_SET, CYREG_SCB1_INTR_M_SET
.set SPILCD_SCB__INTR_RX, CYREG_SCB1_INTR_RX
.set SPILCD_SCB__INTR_RX_MASK, CYREG_SCB1_INTR_RX_MASK
.set SPILCD_SCB__INTR_RX_MASKED, CYREG_SCB1_INTR_RX_MASKED
.set SPILCD_SCB__INTR_RX_SET, CYREG_SCB1_INTR_RX_SET
.set SPILCD_SCB__INTR_S, CYREG_SCB1_INTR_S
.set SPILCD_SCB__INTR_S_MASK, CYREG_SCB1_INTR_S_MASK
.set SPILCD_SCB__INTR_S_MASKED, CYREG_SCB1_INTR_S_MASKED
.set SPILCD_SCB__INTR_S_SET, CYREG_SCB1_INTR_S_SET
.set SPILCD_SCB__INTR_SPI_EC, CYREG_SCB1_INTR_SPI_EC
.set SPILCD_SCB__INTR_SPI_EC_MASK, CYREG_SCB1_INTR_SPI_EC_MASK
.set SPILCD_SCB__INTR_SPI_EC_MASKED, CYREG_SCB1_INTR_SPI_EC_MASKED
.set SPILCD_SCB__INTR_TX, CYREG_SCB1_INTR_TX
.set SPILCD_SCB__INTR_TX_MASK, CYREG_SCB1_INTR_TX_MASK
.set SPILCD_SCB__INTR_TX_MASKED, CYREG_SCB1_INTR_TX_MASKED
.set SPILCD_SCB__INTR_TX_SET, CYREG_SCB1_INTR_TX_SET
.set SPILCD_SCB__RX_CTRL, CYREG_SCB1_RX_CTRL
.set SPILCD_SCB__RX_FIFO_CTRL, CYREG_SCB1_RX_FIFO_CTRL
.set SPILCD_SCB__RX_FIFO_RD, CYREG_SCB1_RX_FIFO_RD
.set SPILCD_SCB__RX_FIFO_RD_SILENT, CYREG_SCB1_RX_FIFO_RD_SILENT
.set SPILCD_SCB__RX_FIFO_STATUS, CYREG_SCB1_RX_FIFO_STATUS
.set SPILCD_SCB__RX_MATCH, CYREG_SCB1_RX_MATCH
.set SPILCD_SCB__SPI_CTRL, CYREG_SCB1_SPI_CTRL
.set SPILCD_SCB__SPI_STATUS, CYREG_SCB1_SPI_STATUS
.set SPILCD_SCB__SS0_POSISTION, 0
.set SPILCD_SCB__SS1_POSISTION, 1
.set SPILCD_SCB__SS2_POSISTION, 2
.set SPILCD_SCB__SS3_POSISTION, 3
.set SPILCD_SCB__STATUS, CYREG_SCB1_STATUS
.set SPILCD_SCB__TX_CTRL, CYREG_SCB1_TX_CTRL
.set SPILCD_SCB__TX_FIFO_CTRL, CYREG_SCB1_TX_FIFO_CTRL
.set SPILCD_SCB__TX_FIFO_STATUS, CYREG_SCB1_TX_FIFO_STATUS
.set SPILCD_SCB__TX_FIFO_WR, CYREG_SCB1_TX_FIFO_WR
.set SPILCD_SCB__UART_CTRL, CYREG_SCB1_UART_CTRL
.set SPILCD_SCB__UART_RX_CTRL, CYREG_SCB1_UART_RX_CTRL
.set SPILCD_SCB__UART_RX_STATUS, CYREG_SCB1_UART_RX_STATUS
.set SPILCD_SCB__UART_TX_CTRL, CYREG_SCB1_UART_TX_CTRL
.set SPILCD_sclk_m__0__DM__MASK, 0x1C0000
.set SPILCD_sclk_m__0__DM__SHIFT, 18
.set SPILCD_sclk_m__0__DR, CYREG_PRT0_DR
.set SPILCD_sclk_m__0__HSIOM, CYREG_HSIOM_PORT_SEL0
.set SPILCD_sclk_m__0__HSIOM_GPIO, 0
.set SPILCD_sclk_m__0__HSIOM_MASK, 0x0F000000
.set SPILCD_sclk_m__0__HSIOM_SHIFT, 24
.set SPILCD_sclk_m__0__HSIOM_SPI, 15
.set SPILCD_sclk_m__0__HSIOM_SPI_CLK, 15
.set SPILCD_sclk_m__0__INTCFG, CYREG_PRT0_INTCFG
.set SPILCD_sclk_m__0__INTSTAT, CYREG_PRT0_INTSTAT
.set SPILCD_sclk_m__0__MASK, 0x40
.set SPILCD_sclk_m__0__OUT_SEL, CYREG_UDB_PA0_CFG10
.set SPILCD_sclk_m__0__OUT_SEL_SHIFT, 12
.set SPILCD_sclk_m__0__OUT_SEL_VAL, -1
.set SPILCD_sclk_m__0__PA__CFG0, CYREG_UDB_PA0_CFG0
.set SPILCD_sclk_m__0__PA__CFG1, CYREG_UDB_PA0_CFG1
.set SPILCD_sclk_m__0__PA__CFG10, CYREG_UDB_PA0_CFG10
.set SPILCD_sclk_m__0__PA__CFG11, CYREG_UDB_PA0_CFG11
.set SPILCD_sclk_m__0__PA__CFG12, CYREG_UDB_PA0_CFG12
.set SPILCD_sclk_m__0__PA__CFG13, CYREG_UDB_PA0_CFG13
.set SPILCD_sclk_m__0__PA__CFG14, CYREG_UDB_PA0_CFG14
.set SPILCD_sclk_m__0__PA__CFG2, CYREG_UDB_PA0_CFG2
.set SPILCD_sclk_m__0__PA__CFG3, CYREG_UDB_PA0_CFG3
.set SPILCD_sclk_m__0__PA__CFG4, CYREG_UDB_PA0_CFG4
.set SPILCD_sclk_m__0__PA__CFG5, CYREG_UDB_PA0_CFG5
.set SPILCD_sclk_m__0__PA__CFG6, CYREG_UDB_PA0_CFG6
.set SPILCD_sclk_m__0__PA__CFG7, CYREG_UDB_PA0_CFG7
.set SPILCD_sclk_m__0__PA__CFG8, CYREG_UDB_PA0_CFG8
.set SPILCD_sclk_m__0__PA__CFG9, CYREG_UDB_PA0_CFG9
.set SPILCD_sclk_m__0__PC, CYREG_PRT0_PC
.set SPILCD_sclk_m__0__PC2, CYREG_PRT0_PC2
.set SPILCD_sclk_m__0__PORT, 0
.set SPILCD_sclk_m__0__PS, CYREG_PRT0_PS
.set SPILCD_sclk_m__0__SHIFT, 6
.set SPILCD_sclk_m__DR, CYREG_PRT0_DR
.set SPILCD_sclk_m__INTCFG, CYREG_PRT0_INTCFG
.set SPILCD_sclk_m__INTSTAT, CYREG_PRT0_INTSTAT
.set SPILCD_sclk_m__MASK, 0x40
.set SPILCD_sclk_m__PA__CFG0, CYREG_UDB_PA0_CFG0
.set SPILCD_sclk_m__PA__CFG1, CYREG_UDB_PA0_CFG1
.set SPILCD_sclk_m__PA__CFG10, CYREG_UDB_PA0_CFG10
.set SPILCD_sclk_m__PA__CFG11, CYREG_UDB_PA0_CFG11
.set SPILCD_sclk_m__PA__CFG12, CYREG_UDB_PA0_CFG12
.set SPILCD_sclk_m__PA__CFG13, CYREG_UDB_PA0_CFG13
.set SPILCD_sclk_m__PA__CFG14, CYREG_UDB_PA0_CFG14
.set SPILCD_sclk_m__PA__CFG2, CYREG_UDB_PA0_CFG2
.set SPILCD_sclk_m__PA__CFG3, CYREG_UDB_PA0_CFG3
.set SPILCD_sclk_m__PA__CFG4, CYREG_UDB_PA0_CFG4
.set SPILCD_sclk_m__PA__CFG5, CYREG_UDB_PA0_CFG5
.set SPILCD_sclk_m__PA__CFG6, CYREG_UDB_PA0_CFG6
.set SPILCD_sclk_m__PA__CFG7, CYREG_UDB_PA0_CFG7
.set SPILCD_sclk_m__PA__CFG8, CYREG_UDB_PA0_CFG8
.set SPILCD_sclk_m__PA__CFG9, CYREG_UDB_PA0_CFG9
.set SPILCD_sclk_m__PC, CYREG_PRT0_PC
.set SPILCD_sclk_m__PC2, CYREG_PRT0_PC2
.set SPILCD_sclk_m__PORT, 0
.set SPILCD_sclk_m__PS, CYREG_PRT0_PS
.set SPILCD_sclk_m__SHIFT, 6

/* Clock_1 */
.set Clock_1__DIVIDER_MASK, 0x0000FFFF
.set Clock_1__ENABLE, CYREG_CLK_DIVIDER_A00
.set Clock_1__ENABLE_MASK, 0x80000000
.set Clock_1__MASK, 0x80000000
.set Clock_1__REGISTER, CYREG_CLK_DIVIDER_A00

/* ISR_Reset */
.set ISR_Reset__INTC_CLR_EN_REG, CYREG_CM0_ICER
.set ISR_Reset__INTC_CLR_PD_REG, CYREG_CM0_ICPR
.set ISR_Reset__INTC_MASK, 0x04
.set ISR_Reset__INTC_NUMBER, 2
.set ISR_Reset__INTC_PRIOR_MASK, 0xC00000
.set ISR_Reset__INTC_PRIOR_NUM, 3
.set ISR_Reset__INTC_PRIOR_REG, CYREG_CM0_IPR0
.set ISR_Reset__INTC_SET_EN_REG, CYREG_CM0_ISER
.set ISR_Reset__INTC_SET_PD_REG, CYREG_CM0_ISPR

/* LCD_RESET */
.set LCD_RESET__0__DM__MASK, 0x1C0000
.set LCD_RESET__0__DM__SHIFT, 18
.set LCD_RESET__0__DR, CYREG_PRT3_DR
.set LCD_RESET__0__HSIOM, CYREG_HSIOM_PORT_SEL3
.set LCD_RESET__0__HSIOM_MASK, 0x0F000000
.set LCD_RESET__0__HSIOM_SHIFT, 24
.set LCD_RESET__0__INTCFG, CYREG_PRT3_INTCFG
.set LCD_RESET__0__INTSTAT, CYREG_PRT3_INTSTAT
.set LCD_RESET__0__MASK, 0x40
.set LCD_RESET__0__PA__CFG0, CYREG_UDB_PA3_CFG0
.set LCD_RESET__0__PA__CFG1, CYREG_UDB_PA3_CFG1
.set LCD_RESET__0__PA__CFG10, CYREG_UDB_PA3_CFG10
.set LCD_RESET__0__PA__CFG11, CYREG_UDB_PA3_CFG11
.set LCD_RESET__0__PA__CFG12, CYREG_UDB_PA3_CFG12
.set LCD_RESET__0__PA__CFG13, CYREG_UDB_PA3_CFG13
.set LCD_RESET__0__PA__CFG14, CYREG_UDB_PA3_CFG14
.set LCD_RESET__0__PA__CFG2, CYREG_UDB_PA3_CFG2
.set LCD_RESET__0__PA__CFG3, CYREG_UDB_PA3_CFG3
.set LCD_RESET__0__PA__CFG4, CYREG_UDB_PA3_CFG4
.set LCD_RESET__0__PA__CFG5, CYREG_UDB_PA3_CFG5
.set LCD_RESET__0__PA__CFG6, CYREG_UDB_PA3_CFG6
.set LCD_RESET__0__PA__CFG7, CYREG_UDB_PA3_CFG7
.set LCD_RESET__0__PA__CFG8, CYREG_UDB_PA3_CFG8
.set LCD_RESET__0__PA__CFG9, CYREG_UDB_PA3_CFG9
.set LCD_RESET__0__PC, CYREG_PRT3_PC
.set LCD_RESET__0__PC2, CYREG_PRT3_PC2
.set LCD_RESET__0__PORT, 3
.set LCD_RESET__0__PS, CYREG_PRT3_PS
.set LCD_RESET__0__SHIFT, 6
.set LCD_RESET__DR, CYREG_PRT3_DR
.set LCD_RESET__INTCFG, CYREG_PRT3_INTCFG
.set LCD_RESET__INTSTAT, CYREG_PRT3_INTSTAT
.set LCD_RESET__MASK, 0x40
.set LCD_RESET__PA__CFG0, CYREG_UDB_PA3_CFG0
.set LCD_RESET__PA__CFG1, CYREG_UDB_PA3_CFG1
.set LCD_RESET__PA__CFG10, CYREG_UDB_PA3_CFG10
.set LCD_RESET__PA__CFG11, CYREG_UDB_PA3_CFG11
.set LCD_RESET__PA__CFG12, CYREG_UDB_PA3_CFG12
.set LCD_RESET__PA__CFG13, CYREG_UDB_PA3_CFG13
.set LCD_RESET__PA__CFG14, CYREG_UDB_PA3_CFG14
.set LCD_RESET__PA__CFG2, CYREG_UDB_PA3_CFG2
.set LCD_RESET__PA__CFG3, CYREG_UDB_PA3_CFG3
.set LCD_RESET__PA__CFG4, CYREG_UDB_PA3_CFG4
.set LCD_RESET__PA__CFG5, CYREG_UDB_PA3_CFG5
.set LCD_RESET__PA__CFG6, CYREG_UDB_PA3_CFG6
.set LCD_RESET__PA__CFG7, CYREG_UDB_PA3_CFG7
.set LCD_RESET__PA__CFG8, CYREG_UDB_PA3_CFG8
.set LCD_RESET__PA__CFG9, CYREG_UDB_PA3_CFG9
.set LCD_RESET__PC, CYREG_PRT3_PC
.set LCD_RESET__PC2, CYREG_PRT3_PC2
.set LCD_RESET__PORT, 3
.set LCD_RESET__PS, CYREG_PRT3_PS
.set LCD_RESET__SHIFT, 6

/* IData_Port */
.set IData_Port__0__DM__MASK, 0x07
.set IData_Port__0__DM__SHIFT, 0
.set IData_Port__0__DR, CYREG_PRT2_DR
.set IData_Port__0__HSIOM, CYREG_HSIOM_PORT_SEL2
.set IData_Port__0__HSIOM_MASK, 0x0000000F
.set IData_Port__0__HSIOM_SHIFT, 0
.set IData_Port__0__INTCFG, CYREG_PRT2_INTCFG
.set IData_Port__0__INTSTAT, CYREG_PRT2_INTSTAT
.set IData_Port__0__MASK, 0x01
.set IData_Port__0__PA__CFG0, CYREG_UDB_PA2_CFG0
.set IData_Port__0__PA__CFG1, CYREG_UDB_PA2_CFG1
.set IData_Port__0__PA__CFG10, CYREG_UDB_PA2_CFG10
.set IData_Port__0__PA__CFG11, CYREG_UDB_PA2_CFG11
.set IData_Port__0__PA__CFG12, CYREG_UDB_PA2_CFG12
.set IData_Port__0__PA__CFG13, CYREG_UDB_PA2_CFG13
.set IData_Port__0__PA__CFG14, CYREG_UDB_PA2_CFG14
.set IData_Port__0__PA__CFG2, CYREG_UDB_PA2_CFG2
.set IData_Port__0__PA__CFG3, CYREG_UDB_PA2_CFG3
.set IData_Port__0__PA__CFG4, CYREG_UDB_PA2_CFG4
.set IData_Port__0__PA__CFG5, CYREG_UDB_PA2_CFG5
.set IData_Port__0__PA__CFG6, CYREG_UDB_PA2_CFG6
.set IData_Port__0__PA__CFG7, CYREG_UDB_PA2_CFG7
.set IData_Port__0__PA__CFG8, CYREG_UDB_PA2_CFG8
.set IData_Port__0__PA__CFG9, CYREG_UDB_PA2_CFG9
.set IData_Port__0__PC, CYREG_PRT2_PC
.set IData_Port__0__PC2, CYREG_PRT2_PC2
.set IData_Port__0__PORT, 2
.set IData_Port__0__PS, CYREG_PRT2_PS
.set IData_Port__0__SHIFT, 0
.set IData_Port__1__DM__MASK, 0x38
.set IData_Port__1__DM__SHIFT, 3
.set IData_Port__1__DR, CYREG_PRT2_DR
.set IData_Port__1__HSIOM, CYREG_HSIOM_PORT_SEL2
.set IData_Port__1__HSIOM_MASK, 0x000000F0
.set IData_Port__1__HSIOM_SHIFT, 4
.set IData_Port__1__INTCFG, CYREG_PRT2_INTCFG
.set IData_Port__1__INTSTAT, CYREG_PRT2_INTSTAT
.set IData_Port__1__MASK, 0x02
.set IData_Port__1__PA__CFG0, CYREG_UDB_PA2_CFG0
.set IData_Port__1__PA__CFG1, CYREG_UDB_PA2_CFG1
.set IData_Port__1__PA__CFG10, CYREG_UDB_PA2_CFG10
.set IData_Port__1__PA__CFG11, CYREG_UDB_PA2_CFG11
.set IData_Port__1__PA__CFG12, CYREG_UDB_PA2_CFG12
.set IData_Port__1__PA__CFG13, CYREG_UDB_PA2_CFG13
.set IData_Port__1__PA__CFG14, CYREG_UDB_PA2_CFG14
.set IData_Port__1__PA__CFG2, CYREG_UDB_PA2_CFG2
.set IData_Port__1__PA__CFG3, CYREG_UDB_PA2_CFG3
.set IData_Port__1__PA__CFG4, CYREG_UDB_PA2_CFG4
.set IData_Port__1__PA__CFG5, CYREG_UDB_PA2_CFG5
.set IData_Port__1__PA__CFG6, CYREG_UDB_PA2_CFG6
.set IData_Port__1__PA__CFG7, CYREG_UDB_PA2_CFG7
.set IData_Port__1__PA__CFG8, CYREG_UDB_PA2_CFG8
.set IData_Port__1__PA__CFG9, CYREG_UDB_PA2_CFG9
.set IData_Port__1__PC, CYREG_PRT2_PC
.set IData_Port__1__PC2, CYREG_PRT2_PC2
.set IData_Port__1__PORT, 2
.set IData_Port__1__PS, CYREG_PRT2_PS
.set IData_Port__1__SHIFT, 1
.set IData_Port__2__DM__MASK, 0x1C0
.set IData_Port__2__DM__SHIFT, 6
.set IData_Port__2__DR, CYREG_PRT2_DR
.set IData_Port__2__HSIOM, CYREG_HSIOM_PORT_SEL2
.set IData_Port__2__HSIOM_MASK, 0x00000F00
.set IData_Port__2__HSIOM_SHIFT, 8
.set IData_Port__2__INTCFG, CYREG_PRT2_INTCFG
.set IData_Port__2__INTSTAT, CYREG_PRT2_INTSTAT
.set IData_Port__2__MASK, 0x04
.set IData_Port__2__PA__CFG0, CYREG_UDB_PA2_CFG0
.set IData_Port__2__PA__CFG1, CYREG_UDB_PA2_CFG1
.set IData_Port__2__PA__CFG10, CYREG_UDB_PA2_CFG10
.set IData_Port__2__PA__CFG11, CYREG_UDB_PA2_CFG11
.set IData_Port__2__PA__CFG12, CYREG_UDB_PA2_CFG12
.set IData_Port__2__PA__CFG13, CYREG_UDB_PA2_CFG13
.set IData_Port__2__PA__CFG14, CYREG_UDB_PA2_CFG14
.set IData_Port__2__PA__CFG2, CYREG_UDB_PA2_CFG2
.set IData_Port__2__PA__CFG3, CYREG_UDB_PA2_CFG3
.set IData_Port__2__PA__CFG4, CYREG_UDB_PA2_CFG4
.set IData_Port__2__PA__CFG5, CYREG_UDB_PA2_CFG5
.set IData_Port__2__PA__CFG6, CYREG_UDB_PA2_CFG6
.set IData_Port__2__PA__CFG7, CYREG_UDB_PA2_CFG7
.set IData_Port__2__PA__CFG8, CYREG_UDB_PA2_CFG8
.set IData_Port__2__PA__CFG9, CYREG_UDB_PA2_CFG9
.set IData_Port__2__PC, CYREG_PRT2_PC
.set IData_Port__2__PC2, CYREG_PRT2_PC2
.set IData_Port__2__PORT, 2
.set IData_Port__2__PS, CYREG_PRT2_PS
.set IData_Port__2__SHIFT, 2
.set IData_Port__3__DM__MASK, 0xE00
.set IData_Port__3__DM__SHIFT, 9
.set IData_Port__3__DR, CYREG_PRT2_DR
.set IData_Port__3__HSIOM, CYREG_HSIOM_PORT_SEL2
.set IData_Port__3__HSIOM_MASK, 0x0000F000
.set IData_Port__3__HSIOM_SHIFT, 12
.set IData_Port__3__INTCFG, CYREG_PRT2_INTCFG
.set IData_Port__3__INTSTAT, CYREG_PRT2_INTSTAT
.set IData_Port__3__MASK, 0x08
.set IData_Port__3__PA__CFG0, CYREG_UDB_PA2_CFG0
.set IData_Port__3__PA__CFG1, CYREG_UDB_PA2_CFG1
.set IData_Port__3__PA__CFG10, CYREG_UDB_PA2_CFG10
.set IData_Port__3__PA__CFG11, CYREG_UDB_PA2_CFG11
.set IData_Port__3__PA__CFG12, CYREG_UDB_PA2_CFG12
.set IData_Port__3__PA__CFG13, CYREG_UDB_PA2_CFG13
.set IData_Port__3__PA__CFG14, CYREG_UDB_PA2_CFG14
.set IData_Port__3__PA__CFG2, CYREG_UDB_PA2_CFG2
.set IData_Port__3__PA__CFG3, CYREG_UDB_PA2_CFG3
.set IData_Port__3__PA__CFG4, CYREG_UDB_PA2_CFG4
.set IData_Port__3__PA__CFG5, CYREG_UDB_PA2_CFG5
.set IData_Port__3__PA__CFG6, CYREG_UDB_PA2_CFG6
.set IData_Port__3__PA__CFG7, CYREG_UDB_PA2_CFG7
.set IData_Port__3__PA__CFG8, CYREG_UDB_PA2_CFG8
.set IData_Port__3__PA__CFG9, CYREG_UDB_PA2_CFG9
.set IData_Port__3__PC, CYREG_PRT2_PC
.set IData_Port__3__PC2, CYREG_PRT2_PC2
.set IData_Port__3__PORT, 2
.set IData_Port__3__PS, CYREG_PRT2_PS
.set IData_Port__3__SHIFT, 3
.set IData_Port__4__DM__MASK, 0x7000
.set IData_Port__4__DM__SHIFT, 12
.set IData_Port__4__DR, CYREG_PRT2_DR
.set IData_Port__4__HSIOM, CYREG_HSIOM_PORT_SEL2
.set IData_Port__4__HSIOM_MASK, 0x000F0000
.set IData_Port__4__HSIOM_SHIFT, 16
.set IData_Port__4__INTCFG, CYREG_PRT2_INTCFG
.set IData_Port__4__INTSTAT, CYREG_PRT2_INTSTAT
.set IData_Port__4__MASK, 0x10
.set IData_Port__4__PA__CFG0, CYREG_UDB_PA2_CFG0
.set IData_Port__4__PA__CFG1, CYREG_UDB_PA2_CFG1
.set IData_Port__4__PA__CFG10, CYREG_UDB_PA2_CFG10
.set IData_Port__4__PA__CFG11, CYREG_UDB_PA2_CFG11
.set IData_Port__4__PA__CFG12, CYREG_UDB_PA2_CFG12
.set IData_Port__4__PA__CFG13, CYREG_UDB_PA2_CFG13
.set IData_Port__4__PA__CFG14, CYREG_UDB_PA2_CFG14
.set IData_Port__4__PA__CFG2, CYREG_UDB_PA2_CFG2
.set IData_Port__4__PA__CFG3, CYREG_UDB_PA2_CFG3
.set IData_Port__4__PA__CFG4, CYREG_UDB_PA2_CFG4
.set IData_Port__4__PA__CFG5, CYREG_UDB_PA2_CFG5
.set IData_Port__4__PA__CFG6, CYREG_UDB_PA2_CFG6
.set IData_Port__4__PA__CFG7, CYREG_UDB_PA2_CFG7
.set IData_Port__4__PA__CFG8, CYREG_UDB_PA2_CFG8
.set IData_Port__4__PA__CFG9, CYREG_UDB_PA2_CFG9
.set IData_Port__4__PC, CYREG_PRT2_PC
.set IData_Port__4__PC2, CYREG_PRT2_PC2
.set IData_Port__4__PORT, 2
.set IData_Port__4__PS, CYREG_PRT2_PS
.set IData_Port__4__SHIFT, 4
.set IData_Port__5__DM__MASK, 0x38000
.set IData_Port__5__DM__SHIFT, 15
.set IData_Port__5__DR, CYREG_PRT2_DR
.set IData_Port__5__HSIOM, CYREG_HSIOM_PORT_SEL2
.set IData_Port__5__HSIOM_MASK, 0x00F00000
.set IData_Port__5__HSIOM_SHIFT, 20
.set IData_Port__5__INTCFG, CYREG_PRT2_INTCFG
.set IData_Port__5__INTSTAT, CYREG_PRT2_INTSTAT
.set IData_Port__5__MASK, 0x20
.set IData_Port__5__PA__CFG0, CYREG_UDB_PA2_CFG0
.set IData_Port__5__PA__CFG1, CYREG_UDB_PA2_CFG1
.set IData_Port__5__PA__CFG10, CYREG_UDB_PA2_CFG10
.set IData_Port__5__PA__CFG11, CYREG_UDB_PA2_CFG11
.set IData_Port__5__PA__CFG12, CYREG_UDB_PA2_CFG12
.set IData_Port__5__PA__CFG13, CYREG_UDB_PA2_CFG13
.set IData_Port__5__PA__CFG14, CYREG_UDB_PA2_CFG14
.set IData_Port__5__PA__CFG2, CYREG_UDB_PA2_CFG2
.set IData_Port__5__PA__CFG3, CYREG_UDB_PA2_CFG3
.set IData_Port__5__PA__CFG4, CYREG_UDB_PA2_CFG4
.set IData_Port__5__PA__CFG5, CYREG_UDB_PA2_CFG5
.set IData_Port__5__PA__CFG6, CYREG_UDB_PA2_CFG6
.set IData_Port__5__PA__CFG7, CYREG_UDB_PA2_CFG7
.set IData_Port__5__PA__CFG8, CYREG_UDB_PA2_CFG8
.set IData_Port__5__PA__CFG9, CYREG_UDB_PA2_CFG9
.set IData_Port__5__PC, CYREG_PRT2_PC
.set IData_Port__5__PC2, CYREG_PRT2_PC2
.set IData_Port__5__PORT, 2
.set IData_Port__5__PS, CYREG_PRT2_PS
.set IData_Port__5__SHIFT, 5
.set IData_Port__6__DM__MASK, 0x1C0000
.set IData_Port__6__DM__SHIFT, 18
.set IData_Port__6__DR, CYREG_PRT2_DR
.set IData_Port__6__HSIOM, CYREG_HSIOM_PORT_SEL2
.set IData_Port__6__HSIOM_MASK, 0x0F000000
.set IData_Port__6__HSIOM_SHIFT, 24
.set IData_Port__6__INTCFG, CYREG_PRT2_INTCFG
.set IData_Port__6__INTSTAT, CYREG_PRT2_INTSTAT
.set IData_Port__6__MASK, 0x40
.set IData_Port__6__PA__CFG0, CYREG_UDB_PA2_CFG0
.set IData_Port__6__PA__CFG1, CYREG_UDB_PA2_CFG1
.set IData_Port__6__PA__CFG10, CYREG_UDB_PA2_CFG10
.set IData_Port__6__PA__CFG11, CYREG_UDB_PA2_CFG11
.set IData_Port__6__PA__CFG12, CYREG_UDB_PA2_CFG12
.set IData_Port__6__PA__CFG13, CYREG_UDB_PA2_CFG13
.set IData_Port__6__PA__CFG14, CYREG_UDB_PA2_CFG14
.set IData_Port__6__PA__CFG2, CYREG_UDB_PA2_CFG2
.set IData_Port__6__PA__CFG3, CYREG_UDB_PA2_CFG3
.set IData_Port__6__PA__CFG4, CYREG_UDB_PA2_CFG4
.set IData_Port__6__PA__CFG5, CYREG_UDB_PA2_CFG5
.set IData_Port__6__PA__CFG6, CYREG_UDB_PA2_CFG6
.set IData_Port__6__PA__CFG7, CYREG_UDB_PA2_CFG7
.set IData_Port__6__PA__CFG8, CYREG_UDB_PA2_CFG8
.set IData_Port__6__PA__CFG9, CYREG_UDB_PA2_CFG9
.set IData_Port__6__PC, CYREG_PRT2_PC
.set IData_Port__6__PC2, CYREG_PRT2_PC2
.set IData_Port__6__PORT, 2
.set IData_Port__6__PS, CYREG_PRT2_PS
.set IData_Port__6__SHIFT, 6
.set IData_Port__7__DM__MASK, 0xE00000
.set IData_Port__7__DM__SHIFT, 21
.set IData_Port__7__DR, CYREG_PRT2_DR
.set IData_Port__7__HSIOM, CYREG_HSIOM_PORT_SEL2
.set IData_Port__7__HSIOM_MASK, 0xF0000000
.set IData_Port__7__HSIOM_SHIFT, 28
.set IData_Port__7__INTCFG, CYREG_PRT2_INTCFG
.set IData_Port__7__INTSTAT, CYREG_PRT2_INTSTAT
.set IData_Port__7__MASK, 0x80
.set IData_Port__7__PA__CFG0, CYREG_UDB_PA2_CFG0
.set IData_Port__7__PA__CFG1, CYREG_UDB_PA2_CFG1
.set IData_Port__7__PA__CFG10, CYREG_UDB_PA2_CFG10
.set IData_Port__7__PA__CFG11, CYREG_UDB_PA2_CFG11
.set IData_Port__7__PA__CFG12, CYREG_UDB_PA2_CFG12
.set IData_Port__7__PA__CFG13, CYREG_UDB_PA2_CFG13
.set IData_Port__7__PA__CFG14, CYREG_UDB_PA2_CFG14
.set IData_Port__7__PA__CFG2, CYREG_UDB_PA2_CFG2
.set IData_Port__7__PA__CFG3, CYREG_UDB_PA2_CFG3
.set IData_Port__7__PA__CFG4, CYREG_UDB_PA2_CFG4
.set IData_Port__7__PA__CFG5, CYREG_UDB_PA2_CFG5
.set IData_Port__7__PA__CFG6, CYREG_UDB_PA2_CFG6
.set IData_Port__7__PA__CFG7, CYREG_UDB_PA2_CFG7
.set IData_Port__7__PA__CFG8, CYREG_UDB_PA2_CFG8
.set IData_Port__7__PA__CFG9, CYREG_UDB_PA2_CFG9
.set IData_Port__7__PC, CYREG_PRT2_PC
.set IData_Port__7__PC2, CYREG_PRT2_PC2
.set IData_Port__7__PORT, 2
.set IData_Port__7__PS, CYREG_PRT2_PS
.set IData_Port__7__SHIFT, 7
.set IData_Port__DR, CYREG_PRT2_DR
.set IData_Port__INTCFG, CYREG_PRT2_INTCFG
.set IData_Port__INTSTAT, CYREG_PRT2_INTSTAT
.set IData_Port__MASK, 0xFF
.set IData_Port__PA__CFG0, CYREG_UDB_PA2_CFG0
.set IData_Port__PA__CFG1, CYREG_UDB_PA2_CFG1
.set IData_Port__PA__CFG10, CYREG_UDB_PA2_CFG10
.set IData_Port__PA__CFG11, CYREG_UDB_PA2_CFG11
.set IData_Port__PA__CFG12, CYREG_UDB_PA2_CFG12
.set IData_Port__PA__CFG13, CYREG_UDB_PA2_CFG13
.set IData_Port__PA__CFG14, CYREG_UDB_PA2_CFG14
.set IData_Port__PA__CFG2, CYREG_UDB_PA2_CFG2
.set IData_Port__PA__CFG3, CYREG_UDB_PA2_CFG3
.set IData_Port__PA__CFG4, CYREG_UDB_PA2_CFG4
.set IData_Port__PA__CFG5, CYREG_UDB_PA2_CFG5
.set IData_Port__PA__CFG6, CYREG_UDB_PA2_CFG6
.set IData_Port__PA__CFG7, CYREG_UDB_PA2_CFG7
.set IData_Port__PA__CFG8, CYREG_UDB_PA2_CFG8
.set IData_Port__PA__CFG9, CYREG_UDB_PA2_CFG9
.set IData_Port__PC, CYREG_PRT2_PC
.set IData_Port__PC2, CYREG_PRT2_PC2
.set IData_Port__PORT, 2
.set IData_Port__PS, CYREG_PRT2_PS
.set IData_Port__SHIFT, 0

/* ISR_Capture */
.set ISR_Capture__INTC_CLR_EN_REG, CYREG_CM0_ICER
.set ISR_Capture__INTC_CLR_PD_REG, CYREG_CM0_ICPR
.set ISR_Capture__INTC_MASK, 0x01
.set ISR_Capture__INTC_NUMBER, 0
.set ISR_Capture__INTC_PRIOR_MASK, 0xC0
.set ISR_Capture__INTC_PRIOR_NUM, 3
.set ISR_Capture__INTC_PRIOR_REG, CYREG_CM0_IPR0
.set ISR_Capture__INTC_SET_EN_REG, CYREG_CM0_ISER
.set ISR_Capture__INTC_SET_PD_REG, CYREG_CM0_ISPR

/* Miscellaneous */
.set CYDEV_BCLK__HFCLK__HZ, 48000000
.set CYDEV_BCLK__HFCLK__KHZ, 48000
.set CYDEV_BCLK__HFCLK__MHZ, 48
.set CYDEV_BCLK__SYSCLK__HZ, 48000000
.set CYDEV_BCLK__SYSCLK__KHZ, 48000
.set CYDEV_BCLK__SYSCLK__MHZ, 48
.set CYDEV_CHIP_DIE_LEOPARD, 1
.set CYDEV_CHIP_DIE_PSOC4A, 24
.set CYDEV_CHIP_DIE_PSOC5LP, 2
.set CYDEV_CHIP_DIE_PSOC5TM, 3
.set CYDEV_CHIP_DIE_TMA4, 4
.set CYDEV_CHIP_DIE_UNKNOWN, 0
.set CYDEV_CHIP_FAMILY_FM0P, 5
.set CYDEV_CHIP_FAMILY_FM3, 6
.set CYDEV_CHIP_FAMILY_FM4, 7
.set CYDEV_CHIP_FAMILY_PSOC3, 1
.set CYDEV_CHIP_FAMILY_PSOC4, 2
.set CYDEV_CHIP_FAMILY_PSOC5, 3
.set CYDEV_CHIP_FAMILY_PSOC6, 4
.set CYDEV_CHIP_FAMILY_UNKNOWN, 0
.set CYDEV_CHIP_FAMILY_USED, CYDEV_CHIP_FAMILY_PSOC4
.set CYDEV_CHIP_JTAG_ID, 0x04C81193
.set CYDEV_CHIP_MEMBER_3A, 1
.set CYDEV_CHIP_MEMBER_4A, 24
.set CYDEV_CHIP_MEMBER_4AA, 23
.set CYDEV_CHIP_MEMBER_4AB, 28
.set CYDEV_CHIP_MEMBER_4AC, 14
.set CYDEV_CHIP_MEMBER_4D, 18
.set CYDEV_CHIP_MEMBER_4E, 6
.set CYDEV_CHIP_MEMBER_4F, 25
.set CYDEV_CHIP_MEMBER_4G, 4
.set CYDEV_CHIP_MEMBER_4H, 22
.set CYDEV_CHIP_MEMBER_4I, 30
.set CYDEV_CHIP_MEMBER_4J, 19
.set CYDEV_CHIP_MEMBER_4K, 20
.set CYDEV_CHIP_MEMBER_4L, 29
.set CYDEV_CHIP_MEMBER_4M, 27
.set CYDEV_CHIP_MEMBER_4N, 11
.set CYDEV_CHIP_MEMBER_4O, 8
.set CYDEV_CHIP_MEMBER_4P, 26
.set CYDEV_CHIP_MEMBER_4Q, 15
.set CYDEV_CHIP_MEMBER_4R, 9
.set CYDEV_CHIP_MEMBER_4S, 12
.set CYDEV_CHIP_MEMBER_4T, 10
.set CYDEV_CHIP_MEMBER_4U, 5
.set CYDEV_CHIP_MEMBER_4V, 21
.set CYDEV_CHIP_MEMBER_4W, 13
.set CYDEV_CHIP_MEMBER_4X, 7
.set CYDEV_CHIP_MEMBER_4Y, 16
.set CYDEV_CHIP_MEMBER_4Z, 17
.set CYDEV_CHIP_MEMBER_5A, 3
.set CYDEV_CHIP_MEMBER_5B, 2
.set CYDEV_CHIP_MEMBER_6A, 31
.set CYDEV_CHIP_MEMBER_FM3, 35
.set CYDEV_CHIP_MEMBER_FM4, 36
.set CYDEV_CHIP_MEMBER_PDL_FM0P_TYPE1, 32
.set CYDEV_CHIP_MEMBER_PDL_FM0P_TYPE2, 33
.set CYDEV_CHIP_MEMBER_PDL_FM0P_TYPE3, 34
.set CYDEV_CHIP_MEMBER_UNKNOWN, 0
.set CYDEV_CHIP_MEMBER_USED, CYDEV_CHIP_MEMBER_4A
.set CYDEV_CHIP_DIE_EXPECT, CYDEV_CHIP_MEMBER_USED
.set CYDEV_CHIP_DIE_ACTUAL, CYDEV_CHIP_DIE_EXPECT
.set CYDEV_CHIP_REV_LEOPARD_ES1, 0
.set CYDEV_CHIP_REV_LEOPARD_ES2, 1
.set CYDEV_CHIP_REV_LEOPARD_ES3, 3
.set CYDEV_CHIP_REV_LEOPARD_PRODUCTION, 3
.set CYDEV_CHIP_REV_PSOC4A_ES0, 17
.set CYDEV_CHIP_REV_PSOC4A_PRODUCTION, 17
.set CYDEV_CHIP_REV_PSOC5LP_ES0, 0
.set CYDEV_CHIP_REV_PSOC5LP_PRODUCTION, 0
.set CYDEV_CHIP_REV_PSOC5TM_ES0, 0
.set CYDEV_CHIP_REV_PSOC5TM_ES1, 1
.set CYDEV_CHIP_REV_PSOC5TM_PRODUCTION, 1
.set CYDEV_CHIP_REV_TMA4_ES, 17
.set CYDEV_CHIP_REV_TMA4_ES2, 33
.set CYDEV_CHIP_REV_TMA4_PRODUCTION, 17
.set CYDEV_CHIP_REVISION_3A_ES1, 0
.set CYDEV_CHIP_REVISION_3A_ES2, 1
.set CYDEV_CHIP_REVISION_3A_ES3, 3
.set CYDEV_CHIP_REVISION_3A_PRODUCTION, 3
.set CYDEV_CHIP_REVISION_4A_ES0, 17
.set CYDEV_CHIP_REVISION_4A_PRODUCTION, 17
.set CYDEV_CHIP_REVISION_4AA_PRODUCTION, 0
.set CYDEV_CHIP_REVISION_4AB_PRODUCTION, 0
.set CYDEV_CHIP_REVISION_4AC_PRODUCTION, 0
.set CYDEV_CHIP_REVISION_4D_PRODUCTION, 0
.set CYDEV_CHIP_REVISION_4E_CCG2_NO_USBPD, 0
.set CYDEV_CHIP_REVISION_4E_PRODUCTION, 0
.set CYDEV_CHIP_REVISION_4F_PRODUCTION, 0
.set CYDEV_CHIP_REVISION_4F_PRODUCTION_256DMA, 0
.set CYDEV_CHIP_REVISION_4F_PRODUCTION_256K, 0
.set CYDEV_CHIP_REVISION_4G_ES, 17
.set CYDEV_CHIP_REVISION_4G_ES2, 33
.set CYDEV_CHIP_REVISION_4G_PRODUCTION, 17
.set CYDEV_CHIP_REVISION_4H_PRODUCTION, 0
.set CYDEV_CHIP_REVISION_4I_PRODUCTION, 0
.set CYDEV_CHIP_REVISION_4J_PRODUCTION, 0
.set CYDEV_CHIP_REVISION_4K_PRODUCTION, 0
.set CYDEV_CHIP_REVISION_4L_PRODUCTION, 0
.set CYDEV_CHIP_REVISION_4M_PRODUCTION, 0
.set CYDEV_CHIP_REVISION_4N_PRODUCTION, 0
.set CYDEV_CHIP_REVISION_4O_PRODUCTION, 0
.set CYDEV_CHIP_REVISION_4P_PRODUCTION, 0
.set CYDEV_CHIP_REVISION_4Q_PRODUCTION, 0
.set CYDEV_CHIP_REVISION_4R_PRODUCTION, 0
.set CYDEV_CHIP_REVISION_4S_PRODUCTION, 0
.set CYDEV_CHIP_REVISION_4T_PRODUCTION, 0
.set CYDEV_CHIP_REVISION_4U_PRODUCTION, 0
.set CYDEV_CHIP_REVISION_4V_PRODUCTION, 0
.set CYDEV_CHIP_REVISION_4W_PRODUCTION, 0
.set CYDEV_CHIP_REVISION_4X_PRODUCTION, 0
.set CYDEV_CHIP_REVISION_4Y_PRODUCTION, 0
.set CYDEV_CHIP_REVISION_4Z_PRODUCTION, 0
.set CYDEV_CHIP_REVISION_5A_ES0, 0
.set CYDEV_CHIP_REVISION_5A_ES1, 1
.set CYDEV_CHIP_REVISION_5A_PRODUCTION, 1
.set CYDEV_CHIP_REVISION_5B_ES0, 0
.set CYDEV_CHIP_REVISION_5B_PRODUCTION, 0
.set CYDEV_CHIP_REVISION_6A_ES, 17
.set CYDEV_CHIP_REVISION_6A_NO_UDB, 33
.set CYDEV_CHIP_REVISION_6A_PRODUCTION, 33
.set CYDEV_CHIP_REVISION_FM3_PRODUCTION, 0
.set CYDEV_CHIP_REVISION_FM4_PRODUCTION, 0
.set CYDEV_CHIP_REVISION_PDL_FM0P_TYPE1_PRODUCTION, 0
.set CYDEV_CHIP_REVISION_PDL_FM0P_TYPE2_PRODUCTION, 0
.set CYDEV_CHIP_REVISION_PDL_FM0P_TYPE3_PRODUCTION, 0
.set CYDEV_CHIP_REVISION_USED, CYDEV_CHIP_REVISION_4A_PRODUCTION
.set CYDEV_CHIP_REV_EXPECT, CYDEV_CHIP_REVISION_USED
.set CYDEV_CONFIG_READ_ACCELERATOR, 1
.set CYDEV_CONFIG_UNUSED_IO_AllowButWarn, 0
.set CYDEV_CONFIG_UNUSED_IO_AllowWithInfo, 1
.set CYDEV_CONFIG_UNUSED_IO_Disallowed, 2
.set CYDEV_CONFIG_UNUSED_IO, CYDEV_CONFIG_UNUSED_IO_Disallowed
.set CYDEV_CONFIGURATION_COMPRESSED, 1
.set CYDEV_CONFIGURATION_MODE_COMPRESSED, 0
.set CYDEV_CONFIGURATION_MODE, CYDEV_CONFIGURATION_MODE_COMPRESSED
.set CYDEV_CONFIGURATION_MODE_DMA, 2
.set CYDEV_CONFIGURATION_MODE_UNCOMPRESSED, 1
.set CYDEV_DEBUG_PROTECT_KILL, 4
.set CYDEV_DEBUG_PROTECT_OPEN, 1
.set CYDEV_DEBUG_PROTECT, CYDEV_DEBUG_PROTECT_OPEN
.set CYDEV_DEBUG_PROTECT_PROTECTED, 2
.set CYDEV_DEBUGGING_DPS_Disable, 3
.set CYDEV_DEBUGGING_DPS_SWD, 2
.set CYDEV_DEBUGGING_DPS, CYDEV_DEBUGGING_DPS_SWD
.set CYDEV_DEBUGGING_ENABLE, 1
.set CYDEV_DFT_SELECT_CLK0, 1
.set CYDEV_DFT_SELECT_CLK1, 2
.set CYDEV_HEAP_SIZE, 0x80
.set CYDEV_IMO_TRIMMED_BY_USB, 0
.set CYDEV_IMO_TRIMMED_BY_WCO, 0
.set CYDEV_IS_EXPORTING_CODE, 0
.set CYDEV_IS_IMPORTING_CODE, 0
.set CYDEV_PROJ_TYPE, 0
.set CYDEV_PROJ_TYPE_BOOTLOADER, 1
.set CYDEV_PROJ_TYPE_LAUNCHER, 5
.set CYDEV_PROJ_TYPE_LOADABLE, 2
.set CYDEV_PROJ_TYPE_LOADABLEANDBOOTLOADER, 4
.set CYDEV_PROJ_TYPE_MULTIAPPBOOTLOADER, 3
.set CYDEV_PROJ_TYPE_STANDARD, 0
.set CYDEV_STACK_SIZE, 0x0400
.set CYDEV_USE_BUNDLED_CMSIS, 1
.set CYDEV_VARIABLE_VDDA, 0
.set CYDEV_VDDA, 5
.set CYDEV_VDDA_MV, 5000
.set CYDEV_VDDD, 5
.set CYDEV_VDDD_MV, 5000
.set CYDEV_WDT_GENERATE_ISR, 1
.set CYIPBLOCK_M0S8_CTBM_VERSION, 0
.set CYIPBLOCK_m0s8cpuss_VERSION, 0
.set CYIPBLOCK_m0s8csd_VERSION, 0
.set CYIPBLOCK_m0s8gpio2_VERSION, 0
.set CYIPBLOCK_m0s8hsiom4a_VERSION, 0
.set CYIPBLOCK_m0s8lcd_VERSION, 0
.set CYIPBLOCK_m0s8lpcomp_VERSION, 0
.set CYIPBLOCK_m0s8pclk_VERSION, 0
.set CYIPBLOCK_m0s8sar_VERSION, 0
.set CYIPBLOCK_m0s8scb_VERSION, 0
.set CYIPBLOCK_m0s8srssv2_VERSION, 1
.set CYIPBLOCK_m0s8tcpwm_VERSION, 0
.set CYIPBLOCK_m0s8udbif_VERSION, 0
.set CYIPBLOCK_S8_GPIO_VERSION, 2
.set CYDEV_BOOTLOADER_ENABLE, 0
.endif

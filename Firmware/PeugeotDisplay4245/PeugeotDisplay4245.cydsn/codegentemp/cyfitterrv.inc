;
; File Name: cyfitterrv.inc
; 
; PSoC Creator  4.3
;
; Description:
; 
;
;-------------------------------------------------------------------------------
; Copyright (c) 2007-2019 Cypress Semiconductor.  All rights reserved.
; You may use this file only in accordance with the license, terms, conditions, 
; disclaimers, and limitations in the end user license agreement accompanying 
; the software package with which this file was provided.
;-------------------------------------------------------------------------------

    IF :LNOT::DEF:INCLUDED_CYFITTERRV_INC
INCLUDED_CYFITTERRV_INC EQU 1
    GET cydevicerv_trm.inc

; E
E__0__DM__MASK EQU 0x38000
E__0__DM__SHIFT EQU 15
E__0__DR EQU CYREG_PRT1_DR
E__0__HSIOM EQU CYREG_HSIOM_PORT_SEL1
E__0__HSIOM_MASK EQU 0x00F00000
E__0__HSIOM_SHIFT EQU 20
E__0__INTCFG EQU CYREG_PRT1_INTCFG
E__0__INTSTAT EQU CYREG_PRT1_INTSTAT
E__0__MASK EQU 0x20
E__0__PA__CFG0 EQU CYREG_UDB_PA1_CFG0
E__0__PA__CFG1 EQU CYREG_UDB_PA1_CFG1
E__0__PA__CFG10 EQU CYREG_UDB_PA1_CFG10
E__0__PA__CFG11 EQU CYREG_UDB_PA1_CFG11
E__0__PA__CFG12 EQU CYREG_UDB_PA1_CFG12
E__0__PA__CFG13 EQU CYREG_UDB_PA1_CFG13
E__0__PA__CFG14 EQU CYREG_UDB_PA1_CFG14
E__0__PA__CFG2 EQU CYREG_UDB_PA1_CFG2
E__0__PA__CFG3 EQU CYREG_UDB_PA1_CFG3
E__0__PA__CFG4 EQU CYREG_UDB_PA1_CFG4
E__0__PA__CFG5 EQU CYREG_UDB_PA1_CFG5
E__0__PA__CFG6 EQU CYREG_UDB_PA1_CFG6
E__0__PA__CFG7 EQU CYREG_UDB_PA1_CFG7
E__0__PA__CFG8 EQU CYREG_UDB_PA1_CFG8
E__0__PA__CFG9 EQU CYREG_UDB_PA1_CFG9
E__0__PC EQU CYREG_PRT1_PC
E__0__PC2 EQU CYREG_PRT1_PC2
E__0__PORT EQU 1
E__0__PS EQU CYREG_PRT1_PS
E__0__SHIFT EQU 5
E__DR EQU CYREG_PRT1_DR
E__INTCFG EQU CYREG_PRT1_INTCFG
E__INTSTAT EQU CYREG_PRT1_INTSTAT
E__MASK EQU 0x20
E__PA__CFG0 EQU CYREG_UDB_PA1_CFG0
E__PA__CFG1 EQU CYREG_UDB_PA1_CFG1
E__PA__CFG10 EQU CYREG_UDB_PA1_CFG10
E__PA__CFG11 EQU CYREG_UDB_PA1_CFG11
E__PA__CFG12 EQU CYREG_UDB_PA1_CFG12
E__PA__CFG13 EQU CYREG_UDB_PA1_CFG13
E__PA__CFG14 EQU CYREG_UDB_PA1_CFG14
E__PA__CFG2 EQU CYREG_UDB_PA1_CFG2
E__PA__CFG3 EQU CYREG_UDB_PA1_CFG3
E__PA__CFG4 EQU CYREG_UDB_PA1_CFG4
E__PA__CFG5 EQU CYREG_UDB_PA1_CFG5
E__PA__CFG6 EQU CYREG_UDB_PA1_CFG6
E__PA__CFG7 EQU CYREG_UDB_PA1_CFG7
E__PA__CFG8 EQU CYREG_UDB_PA1_CFG8
E__PA__CFG9 EQU CYREG_UDB_PA1_CFG9
E__PC EQU CYREG_PRT1_PC
E__PC2 EQU CYREG_PRT1_PC2
E__PORT EQU 1
E__PS EQU CYREG_PRT1_PS
E__SHIFT EQU 5

; A0
A0__0__DM__MASK EQU 0x7000
A0__0__DM__SHIFT EQU 12
A0__0__DR EQU CYREG_PRT1_DR
A0__0__HSIOM EQU CYREG_HSIOM_PORT_SEL1
A0__0__HSIOM_MASK EQU 0x000F0000
A0__0__HSIOM_SHIFT EQU 16
A0__0__INTCFG EQU CYREG_PRT1_INTCFG
A0__0__INTSTAT EQU CYREG_PRT1_INTSTAT
A0__0__MASK EQU 0x10
A0__0__PA__CFG0 EQU CYREG_UDB_PA1_CFG0
A0__0__PA__CFG1 EQU CYREG_UDB_PA1_CFG1
A0__0__PA__CFG10 EQU CYREG_UDB_PA1_CFG10
A0__0__PA__CFG11 EQU CYREG_UDB_PA1_CFG11
A0__0__PA__CFG12 EQU CYREG_UDB_PA1_CFG12
A0__0__PA__CFG13 EQU CYREG_UDB_PA1_CFG13
A0__0__PA__CFG14 EQU CYREG_UDB_PA1_CFG14
A0__0__PA__CFG2 EQU CYREG_UDB_PA1_CFG2
A0__0__PA__CFG3 EQU CYREG_UDB_PA1_CFG3
A0__0__PA__CFG4 EQU CYREG_UDB_PA1_CFG4
A0__0__PA__CFG5 EQU CYREG_UDB_PA1_CFG5
A0__0__PA__CFG6 EQU CYREG_UDB_PA1_CFG6
A0__0__PA__CFG7 EQU CYREG_UDB_PA1_CFG7
A0__0__PA__CFG8 EQU CYREG_UDB_PA1_CFG8
A0__0__PA__CFG9 EQU CYREG_UDB_PA1_CFG9
A0__0__PC EQU CYREG_PRT1_PC
A0__0__PC2 EQU CYREG_PRT1_PC2
A0__0__PORT EQU 1
A0__0__PS EQU CYREG_PRT1_PS
A0__0__SHIFT EQU 4
A0__DR EQU CYREG_PRT1_DR
A0__INTCFG EQU CYREG_PRT1_INTCFG
A0__INTSTAT EQU CYREG_PRT1_INTSTAT
A0__MASK EQU 0x10
A0__PA__CFG0 EQU CYREG_UDB_PA1_CFG0
A0__PA__CFG1 EQU CYREG_UDB_PA1_CFG1
A0__PA__CFG10 EQU CYREG_UDB_PA1_CFG10
A0__PA__CFG11 EQU CYREG_UDB_PA1_CFG11
A0__PA__CFG12 EQU CYREG_UDB_PA1_CFG12
A0__PA__CFG13 EQU CYREG_UDB_PA1_CFG13
A0__PA__CFG14 EQU CYREG_UDB_PA1_CFG14
A0__PA__CFG2 EQU CYREG_UDB_PA1_CFG2
A0__PA__CFG3 EQU CYREG_UDB_PA1_CFG3
A0__PA__CFG4 EQU CYREG_UDB_PA1_CFG4
A0__PA__CFG5 EQU CYREG_UDB_PA1_CFG5
A0__PA__CFG6 EQU CYREG_UDB_PA1_CFG6
A0__PA__CFG7 EQU CYREG_UDB_PA1_CFG7
A0__PA__CFG8 EQU CYREG_UDB_PA1_CFG8
A0__PA__CFG9 EQU CYREG_UDB_PA1_CFG9
A0__PC EQU CYREG_PRT1_PC
A0__PC2 EQU CYREG_PRT1_PC2
A0__PORT EQU 1
A0__PS EQU CYREG_PRT1_PS
A0__SHIFT EQU 4

; CS
CS__0__DM__MASK EQU 0x1C0
CS__0__DM__SHIFT EQU 6
CS__0__DR EQU CYREG_PRT1_DR
CS__0__HSIOM EQU CYREG_HSIOM_PORT_SEL1
CS__0__HSIOM_MASK EQU 0x00000F00
CS__0__HSIOM_SHIFT EQU 8
CS__0__INTCFG EQU CYREG_PRT1_INTCFG
CS__0__INTSTAT EQU CYREG_PRT1_INTSTAT
CS__0__MASK EQU 0x04
CS__0__PA__CFG0 EQU CYREG_UDB_PA1_CFG0
CS__0__PA__CFG1 EQU CYREG_UDB_PA1_CFG1
CS__0__PA__CFG10 EQU CYREG_UDB_PA1_CFG10
CS__0__PA__CFG11 EQU CYREG_UDB_PA1_CFG11
CS__0__PA__CFG12 EQU CYREG_UDB_PA1_CFG12
CS__0__PA__CFG13 EQU CYREG_UDB_PA1_CFG13
CS__0__PA__CFG14 EQU CYREG_UDB_PA1_CFG14
CS__0__PA__CFG2 EQU CYREG_UDB_PA1_CFG2
CS__0__PA__CFG3 EQU CYREG_UDB_PA1_CFG3
CS__0__PA__CFG4 EQU CYREG_UDB_PA1_CFG4
CS__0__PA__CFG5 EQU CYREG_UDB_PA1_CFG5
CS__0__PA__CFG6 EQU CYREG_UDB_PA1_CFG6
CS__0__PA__CFG7 EQU CYREG_UDB_PA1_CFG7
CS__0__PA__CFG8 EQU CYREG_UDB_PA1_CFG8
CS__0__PA__CFG9 EQU CYREG_UDB_PA1_CFG9
CS__0__PC EQU CYREG_PRT1_PC
CS__0__PC2 EQU CYREG_PRT1_PC2
CS__0__PORT EQU 1
CS__0__PS EQU CYREG_PRT1_PS
CS__0__SHIFT EQU 2
CS__DR EQU CYREG_PRT1_DR
CS__INTCFG EQU CYREG_PRT1_INTCFG
CS__INTSTAT EQU CYREG_PRT1_INTSTAT
CS__MASK EQU 0x04
CS__PA__CFG0 EQU CYREG_UDB_PA1_CFG0
CS__PA__CFG1 EQU CYREG_UDB_PA1_CFG1
CS__PA__CFG10 EQU CYREG_UDB_PA1_CFG10
CS__PA__CFG11 EQU CYREG_UDB_PA1_CFG11
CS__PA__CFG12 EQU CYREG_UDB_PA1_CFG12
CS__PA__CFG13 EQU CYREG_UDB_PA1_CFG13
CS__PA__CFG14 EQU CYREG_UDB_PA1_CFG14
CS__PA__CFG2 EQU CYREG_UDB_PA1_CFG2
CS__PA__CFG3 EQU CYREG_UDB_PA1_CFG3
CS__PA__CFG4 EQU CYREG_UDB_PA1_CFG4
CS__PA__CFG5 EQU CYREG_UDB_PA1_CFG5
CS__PA__CFG6 EQU CYREG_UDB_PA1_CFG6
CS__PA__CFG7 EQU CYREG_UDB_PA1_CFG7
CS__PA__CFG8 EQU CYREG_UDB_PA1_CFG8
CS__PA__CFG9 EQU CYREG_UDB_PA1_CFG9
CS__PC EQU CYREG_PRT1_PC
CS__PC2 EQU CYREG_PRT1_PC2
CS__PORT EQU 1
CS__PS EQU CYREG_PRT1_PS
CS__SHIFT EQU 2

; RESET
RESET__0__DM__MASK EQU 0xE00
RESET__0__DM__SHIFT EQU 9
RESET__0__DR EQU CYREG_PRT1_DR
RESET__0__HSIOM EQU CYREG_HSIOM_PORT_SEL1
RESET__0__HSIOM_MASK EQU 0x0000F000
RESET__0__HSIOM_SHIFT EQU 12
RESET__0__INTCFG EQU CYREG_PRT1_INTCFG
RESET__0__INTSTAT EQU CYREG_PRT1_INTSTAT
RESET__0__MASK EQU 0x08
RESET__0__PA__CFG0 EQU CYREG_UDB_PA1_CFG0
RESET__0__PA__CFG1 EQU CYREG_UDB_PA1_CFG1
RESET__0__PA__CFG10 EQU CYREG_UDB_PA1_CFG10
RESET__0__PA__CFG11 EQU CYREG_UDB_PA1_CFG11
RESET__0__PA__CFG12 EQU CYREG_UDB_PA1_CFG12
RESET__0__PA__CFG13 EQU CYREG_UDB_PA1_CFG13
RESET__0__PA__CFG14 EQU CYREG_UDB_PA1_CFG14
RESET__0__PA__CFG2 EQU CYREG_UDB_PA1_CFG2
RESET__0__PA__CFG3 EQU CYREG_UDB_PA1_CFG3
RESET__0__PA__CFG4 EQU CYREG_UDB_PA1_CFG4
RESET__0__PA__CFG5 EQU CYREG_UDB_PA1_CFG5
RESET__0__PA__CFG6 EQU CYREG_UDB_PA1_CFG6
RESET__0__PA__CFG7 EQU CYREG_UDB_PA1_CFG7
RESET__0__PA__CFG8 EQU CYREG_UDB_PA1_CFG8
RESET__0__PA__CFG9 EQU CYREG_UDB_PA1_CFG9
RESET__0__PC EQU CYREG_PRT1_PC
RESET__0__PC2 EQU CYREG_PRT1_PC2
RESET__0__PORT EQU 1
RESET__0__PS EQU CYREG_PRT1_PS
RESET__0__SHIFT EQU 3
RESET__DR EQU CYREG_PRT1_DR
RESET__INTCFG EQU CYREG_PRT1_INTCFG
RESET__INTSTAT EQU CYREG_PRT1_INTSTAT
RESET__MASK EQU 0x08
RESET__PA__CFG0 EQU CYREG_UDB_PA1_CFG0
RESET__PA__CFG1 EQU CYREG_UDB_PA1_CFG1
RESET__PA__CFG10 EQU CYREG_UDB_PA1_CFG10
RESET__PA__CFG11 EQU CYREG_UDB_PA1_CFG11
RESET__PA__CFG12 EQU CYREG_UDB_PA1_CFG12
RESET__PA__CFG13 EQU CYREG_UDB_PA1_CFG13
RESET__PA__CFG14 EQU CYREG_UDB_PA1_CFG14
RESET__PA__CFG2 EQU CYREG_UDB_PA1_CFG2
RESET__PA__CFG3 EQU CYREG_UDB_PA1_CFG3
RESET__PA__CFG4 EQU CYREG_UDB_PA1_CFG4
RESET__PA__CFG5 EQU CYREG_UDB_PA1_CFG5
RESET__PA__CFG6 EQU CYREG_UDB_PA1_CFG6
RESET__PA__CFG7 EQU CYREG_UDB_PA1_CFG7
RESET__PA__CFG8 EQU CYREG_UDB_PA1_CFG8
RESET__PA__CFG9 EQU CYREG_UDB_PA1_CFG9
RESET__PC EQU CYREG_PRT1_PC
RESET__PC2 EQU CYREG_PRT1_PC2
RESET__PORT EQU 1
RESET__PS EQU CYREG_PRT1_PS
RESET__SHIFT EQU 3

; LCD_CD
LCD_CD__0__DM__MASK EQU 0xE00000
LCD_CD__0__DM__SHIFT EQU 21
LCD_CD__0__DR EQU CYREG_PRT3_DR
LCD_CD__0__HSIOM EQU CYREG_HSIOM_PORT_SEL3
LCD_CD__0__HSIOM_MASK EQU 0xF0000000
LCD_CD__0__HSIOM_SHIFT EQU 28
LCD_CD__0__INTCFG EQU CYREG_PRT3_INTCFG
LCD_CD__0__INTSTAT EQU CYREG_PRT3_INTSTAT
LCD_CD__0__MASK EQU 0x80
LCD_CD__0__PA__CFG0 EQU CYREG_UDB_PA3_CFG0
LCD_CD__0__PA__CFG1 EQU CYREG_UDB_PA3_CFG1
LCD_CD__0__PA__CFG10 EQU CYREG_UDB_PA3_CFG10
LCD_CD__0__PA__CFG11 EQU CYREG_UDB_PA3_CFG11
LCD_CD__0__PA__CFG12 EQU CYREG_UDB_PA3_CFG12
LCD_CD__0__PA__CFG13 EQU CYREG_UDB_PA3_CFG13
LCD_CD__0__PA__CFG14 EQU CYREG_UDB_PA3_CFG14
LCD_CD__0__PA__CFG2 EQU CYREG_UDB_PA3_CFG2
LCD_CD__0__PA__CFG3 EQU CYREG_UDB_PA3_CFG3
LCD_CD__0__PA__CFG4 EQU CYREG_UDB_PA3_CFG4
LCD_CD__0__PA__CFG5 EQU CYREG_UDB_PA3_CFG5
LCD_CD__0__PA__CFG6 EQU CYREG_UDB_PA3_CFG6
LCD_CD__0__PA__CFG7 EQU CYREG_UDB_PA3_CFG7
LCD_CD__0__PA__CFG8 EQU CYREG_UDB_PA3_CFG8
LCD_CD__0__PA__CFG9 EQU CYREG_UDB_PA3_CFG9
LCD_CD__0__PC EQU CYREG_PRT3_PC
LCD_CD__0__PC2 EQU CYREG_PRT3_PC2
LCD_CD__0__PORT EQU 3
LCD_CD__0__PS EQU CYREG_PRT3_PS
LCD_CD__0__SHIFT EQU 7
LCD_CD__DR EQU CYREG_PRT3_DR
LCD_CD__INTCFG EQU CYREG_PRT3_INTCFG
LCD_CD__INTSTAT EQU CYREG_PRT3_INTSTAT
LCD_CD__MASK EQU 0x80
LCD_CD__PA__CFG0 EQU CYREG_UDB_PA3_CFG0
LCD_CD__PA__CFG1 EQU CYREG_UDB_PA3_CFG1
LCD_CD__PA__CFG10 EQU CYREG_UDB_PA3_CFG10
LCD_CD__PA__CFG11 EQU CYREG_UDB_PA3_CFG11
LCD_CD__PA__CFG12 EQU CYREG_UDB_PA3_CFG12
LCD_CD__PA__CFG13 EQU CYREG_UDB_PA3_CFG13
LCD_CD__PA__CFG14 EQU CYREG_UDB_PA3_CFG14
LCD_CD__PA__CFG2 EQU CYREG_UDB_PA3_CFG2
LCD_CD__PA__CFG3 EQU CYREG_UDB_PA3_CFG3
LCD_CD__PA__CFG4 EQU CYREG_UDB_PA3_CFG4
LCD_CD__PA__CFG5 EQU CYREG_UDB_PA3_CFG5
LCD_CD__PA__CFG6 EQU CYREG_UDB_PA3_CFG6
LCD_CD__PA__CFG7 EQU CYREG_UDB_PA3_CFG7
LCD_CD__PA__CFG8 EQU CYREG_UDB_PA3_CFG8
LCD_CD__PA__CFG9 EQU CYREG_UDB_PA3_CFG9
LCD_CD__PC EQU CYREG_PRT3_PC
LCD_CD__PC2 EQU CYREG_PRT3_PC2
LCD_CD__PORT EQU 3
LCD_CD__PS EQU CYREG_PRT3_PS
LCD_CD__SHIFT EQU 7

; SPILCD
SPILCD_mosi_m__0__DM__MASK EQU 0x7000
SPILCD_mosi_m__0__DM__SHIFT EQU 12
SPILCD_mosi_m__0__DR EQU CYREG_PRT0_DR
SPILCD_mosi_m__0__HSIOM EQU CYREG_HSIOM_PORT_SEL0
SPILCD_mosi_m__0__HSIOM_GPIO EQU 0
SPILCD_mosi_m__0__HSIOM_I2C EQU 14
SPILCD_mosi_m__0__HSIOM_I2C_SCL EQU 14
SPILCD_mosi_m__0__HSIOM_MASK EQU 0x000F0000
SPILCD_mosi_m__0__HSIOM_SHIFT EQU 16
SPILCD_mosi_m__0__HSIOM_SPI EQU 15
SPILCD_mosi_m__0__HSIOM_SPI_MOSI EQU 15
SPILCD_mosi_m__0__HSIOM_UART EQU 9
SPILCD_mosi_m__0__HSIOM_UART_RX EQU 9
SPILCD_mosi_m__0__INTCFG EQU CYREG_PRT0_INTCFG
SPILCD_mosi_m__0__INTSTAT EQU CYREG_PRT0_INTSTAT
SPILCD_mosi_m__0__MASK EQU 0x10
SPILCD_mosi_m__0__OUT_SEL EQU CYREG_UDB_PA0_CFG10
SPILCD_mosi_m__0__OUT_SEL_SHIFT EQU 8
SPILCD_mosi_m__0__OUT_SEL_VAL EQU -1
SPILCD_mosi_m__0__PA__CFG0 EQU CYREG_UDB_PA0_CFG0
SPILCD_mosi_m__0__PA__CFG1 EQU CYREG_UDB_PA0_CFG1
SPILCD_mosi_m__0__PA__CFG10 EQU CYREG_UDB_PA0_CFG10
SPILCD_mosi_m__0__PA__CFG11 EQU CYREG_UDB_PA0_CFG11
SPILCD_mosi_m__0__PA__CFG12 EQU CYREG_UDB_PA0_CFG12
SPILCD_mosi_m__0__PA__CFG13 EQU CYREG_UDB_PA0_CFG13
SPILCD_mosi_m__0__PA__CFG14 EQU CYREG_UDB_PA0_CFG14
SPILCD_mosi_m__0__PA__CFG2 EQU CYREG_UDB_PA0_CFG2
SPILCD_mosi_m__0__PA__CFG3 EQU CYREG_UDB_PA0_CFG3
SPILCD_mosi_m__0__PA__CFG4 EQU CYREG_UDB_PA0_CFG4
SPILCD_mosi_m__0__PA__CFG5 EQU CYREG_UDB_PA0_CFG5
SPILCD_mosi_m__0__PA__CFG6 EQU CYREG_UDB_PA0_CFG6
SPILCD_mosi_m__0__PA__CFG7 EQU CYREG_UDB_PA0_CFG7
SPILCD_mosi_m__0__PA__CFG8 EQU CYREG_UDB_PA0_CFG8
SPILCD_mosi_m__0__PA__CFG9 EQU CYREG_UDB_PA0_CFG9
SPILCD_mosi_m__0__PC EQU CYREG_PRT0_PC
SPILCD_mosi_m__0__PC2 EQU CYREG_PRT0_PC2
SPILCD_mosi_m__0__PORT EQU 0
SPILCD_mosi_m__0__PS EQU CYREG_PRT0_PS
SPILCD_mosi_m__0__SHIFT EQU 4
SPILCD_mosi_m__DR EQU CYREG_PRT0_DR
SPILCD_mosi_m__INTCFG EQU CYREG_PRT0_INTCFG
SPILCD_mosi_m__INTSTAT EQU CYREG_PRT0_INTSTAT
SPILCD_mosi_m__MASK EQU 0x10
SPILCD_mosi_m__PA__CFG0 EQU CYREG_UDB_PA0_CFG0
SPILCD_mosi_m__PA__CFG1 EQU CYREG_UDB_PA0_CFG1
SPILCD_mosi_m__PA__CFG10 EQU CYREG_UDB_PA0_CFG10
SPILCD_mosi_m__PA__CFG11 EQU CYREG_UDB_PA0_CFG11
SPILCD_mosi_m__PA__CFG12 EQU CYREG_UDB_PA0_CFG12
SPILCD_mosi_m__PA__CFG13 EQU CYREG_UDB_PA0_CFG13
SPILCD_mosi_m__PA__CFG14 EQU CYREG_UDB_PA0_CFG14
SPILCD_mosi_m__PA__CFG2 EQU CYREG_UDB_PA0_CFG2
SPILCD_mosi_m__PA__CFG3 EQU CYREG_UDB_PA0_CFG3
SPILCD_mosi_m__PA__CFG4 EQU CYREG_UDB_PA0_CFG4
SPILCD_mosi_m__PA__CFG5 EQU CYREG_UDB_PA0_CFG5
SPILCD_mosi_m__PA__CFG6 EQU CYREG_UDB_PA0_CFG6
SPILCD_mosi_m__PA__CFG7 EQU CYREG_UDB_PA0_CFG7
SPILCD_mosi_m__PA__CFG8 EQU CYREG_UDB_PA0_CFG8
SPILCD_mosi_m__PA__CFG9 EQU CYREG_UDB_PA0_CFG9
SPILCD_mosi_m__PC EQU CYREG_PRT0_PC
SPILCD_mosi_m__PC2 EQU CYREG_PRT0_PC2
SPILCD_mosi_m__PORT EQU 0
SPILCD_mosi_m__PS EQU CYREG_PRT0_PS
SPILCD_mosi_m__SHIFT EQU 4
SPILCD_SCB__BIST_CONTROL EQU CYREG_SCB1_BIST_CONTROL
SPILCD_SCB__BIST_DATA EQU CYREG_SCB1_BIST_DATA
SPILCD_SCB__CTRL EQU CYREG_SCB1_CTRL
SPILCD_SCB__EZ_DATA00 EQU CYREG_SCB1_EZ_DATA00
SPILCD_SCB__EZ_DATA01 EQU CYREG_SCB1_EZ_DATA01
SPILCD_SCB__EZ_DATA02 EQU CYREG_SCB1_EZ_DATA02
SPILCD_SCB__EZ_DATA03 EQU CYREG_SCB1_EZ_DATA03
SPILCD_SCB__EZ_DATA04 EQU CYREG_SCB1_EZ_DATA04
SPILCD_SCB__EZ_DATA05 EQU CYREG_SCB1_EZ_DATA05
SPILCD_SCB__EZ_DATA06 EQU CYREG_SCB1_EZ_DATA06
SPILCD_SCB__EZ_DATA07 EQU CYREG_SCB1_EZ_DATA07
SPILCD_SCB__EZ_DATA08 EQU CYREG_SCB1_EZ_DATA08
SPILCD_SCB__EZ_DATA09 EQU CYREG_SCB1_EZ_DATA09
SPILCD_SCB__EZ_DATA10 EQU CYREG_SCB1_EZ_DATA10
SPILCD_SCB__EZ_DATA11 EQU CYREG_SCB1_EZ_DATA11
SPILCD_SCB__EZ_DATA12 EQU CYREG_SCB1_EZ_DATA12
SPILCD_SCB__EZ_DATA13 EQU CYREG_SCB1_EZ_DATA13
SPILCD_SCB__EZ_DATA14 EQU CYREG_SCB1_EZ_DATA14
SPILCD_SCB__EZ_DATA15 EQU CYREG_SCB1_EZ_DATA15
SPILCD_SCB__EZ_DATA16 EQU CYREG_SCB1_EZ_DATA16
SPILCD_SCB__EZ_DATA17 EQU CYREG_SCB1_EZ_DATA17
SPILCD_SCB__EZ_DATA18 EQU CYREG_SCB1_EZ_DATA18
SPILCD_SCB__EZ_DATA19 EQU CYREG_SCB1_EZ_DATA19
SPILCD_SCB__EZ_DATA20 EQU CYREG_SCB1_EZ_DATA20
SPILCD_SCB__EZ_DATA21 EQU CYREG_SCB1_EZ_DATA21
SPILCD_SCB__EZ_DATA22 EQU CYREG_SCB1_EZ_DATA22
SPILCD_SCB__EZ_DATA23 EQU CYREG_SCB1_EZ_DATA23
SPILCD_SCB__EZ_DATA24 EQU CYREG_SCB1_EZ_DATA24
SPILCD_SCB__EZ_DATA25 EQU CYREG_SCB1_EZ_DATA25
SPILCD_SCB__EZ_DATA26 EQU CYREG_SCB1_EZ_DATA26
SPILCD_SCB__EZ_DATA27 EQU CYREG_SCB1_EZ_DATA27
SPILCD_SCB__EZ_DATA28 EQU CYREG_SCB1_EZ_DATA28
SPILCD_SCB__EZ_DATA29 EQU CYREG_SCB1_EZ_DATA29
SPILCD_SCB__EZ_DATA30 EQU CYREG_SCB1_EZ_DATA30
SPILCD_SCB__EZ_DATA31 EQU CYREG_SCB1_EZ_DATA31
SPILCD_SCB__I2C_CFG EQU CYREG_SCB1_I2C_CFG
SPILCD_SCB__I2C_CTRL EQU CYREG_SCB1_I2C_CTRL
SPILCD_SCB__I2C_M_CMD EQU CYREG_SCB1_I2C_M_CMD
SPILCD_SCB__I2C_S_CMD EQU CYREG_SCB1_I2C_S_CMD
SPILCD_SCB__I2C_STATUS EQU CYREG_SCB1_I2C_STATUS
SPILCD_SCB__INTR_CAUSE EQU CYREG_SCB1_INTR_CAUSE
SPILCD_SCB__INTR_I2C_EC EQU CYREG_SCB1_INTR_I2C_EC
SPILCD_SCB__INTR_I2C_EC_MASK EQU CYREG_SCB1_INTR_I2C_EC_MASK
SPILCD_SCB__INTR_I2C_EC_MASKED EQU CYREG_SCB1_INTR_I2C_EC_MASKED
SPILCD_SCB__INTR_M EQU CYREG_SCB1_INTR_M
SPILCD_SCB__INTR_M_MASK EQU CYREG_SCB1_INTR_M_MASK
SPILCD_SCB__INTR_M_MASKED EQU CYREG_SCB1_INTR_M_MASKED
SPILCD_SCB__INTR_M_SET EQU CYREG_SCB1_INTR_M_SET
SPILCD_SCB__INTR_RX EQU CYREG_SCB1_INTR_RX
SPILCD_SCB__INTR_RX_MASK EQU CYREG_SCB1_INTR_RX_MASK
SPILCD_SCB__INTR_RX_MASKED EQU CYREG_SCB1_INTR_RX_MASKED
SPILCD_SCB__INTR_RX_SET EQU CYREG_SCB1_INTR_RX_SET
SPILCD_SCB__INTR_S EQU CYREG_SCB1_INTR_S
SPILCD_SCB__INTR_S_MASK EQU CYREG_SCB1_INTR_S_MASK
SPILCD_SCB__INTR_S_MASKED EQU CYREG_SCB1_INTR_S_MASKED
SPILCD_SCB__INTR_S_SET EQU CYREG_SCB1_INTR_S_SET
SPILCD_SCB__INTR_SPI_EC EQU CYREG_SCB1_INTR_SPI_EC
SPILCD_SCB__INTR_SPI_EC_MASK EQU CYREG_SCB1_INTR_SPI_EC_MASK
SPILCD_SCB__INTR_SPI_EC_MASKED EQU CYREG_SCB1_INTR_SPI_EC_MASKED
SPILCD_SCB__INTR_TX EQU CYREG_SCB1_INTR_TX
SPILCD_SCB__INTR_TX_MASK EQU CYREG_SCB1_INTR_TX_MASK
SPILCD_SCB__INTR_TX_MASKED EQU CYREG_SCB1_INTR_TX_MASKED
SPILCD_SCB__INTR_TX_SET EQU CYREG_SCB1_INTR_TX_SET
SPILCD_SCB__RX_CTRL EQU CYREG_SCB1_RX_CTRL
SPILCD_SCB__RX_FIFO_CTRL EQU CYREG_SCB1_RX_FIFO_CTRL
SPILCD_SCB__RX_FIFO_RD EQU CYREG_SCB1_RX_FIFO_RD
SPILCD_SCB__RX_FIFO_RD_SILENT EQU CYREG_SCB1_RX_FIFO_RD_SILENT
SPILCD_SCB__RX_FIFO_STATUS EQU CYREG_SCB1_RX_FIFO_STATUS
SPILCD_SCB__RX_MATCH EQU CYREG_SCB1_RX_MATCH
SPILCD_SCB__SPI_CTRL EQU CYREG_SCB1_SPI_CTRL
SPILCD_SCB__SPI_STATUS EQU CYREG_SCB1_SPI_STATUS
SPILCD_SCB__SS0_POSISTION EQU 0
SPILCD_SCB__SS1_POSISTION EQU 1
SPILCD_SCB__SS2_POSISTION EQU 2
SPILCD_SCB__SS3_POSISTION EQU 3
SPILCD_SCB__STATUS EQU CYREG_SCB1_STATUS
SPILCD_SCB__TX_CTRL EQU CYREG_SCB1_TX_CTRL
SPILCD_SCB__TX_FIFO_CTRL EQU CYREG_SCB1_TX_FIFO_CTRL
SPILCD_SCB__TX_FIFO_STATUS EQU CYREG_SCB1_TX_FIFO_STATUS
SPILCD_SCB__TX_FIFO_WR EQU CYREG_SCB1_TX_FIFO_WR
SPILCD_SCB__UART_CTRL EQU CYREG_SCB1_UART_CTRL
SPILCD_SCB__UART_RX_CTRL EQU CYREG_SCB1_UART_RX_CTRL
SPILCD_SCB__UART_RX_STATUS EQU CYREG_SCB1_UART_RX_STATUS
SPILCD_SCB__UART_TX_CTRL EQU CYREG_SCB1_UART_TX_CTRL
SPILCD_sclk_m__0__DM__MASK EQU 0x1C0000
SPILCD_sclk_m__0__DM__SHIFT EQU 18
SPILCD_sclk_m__0__DR EQU CYREG_PRT0_DR
SPILCD_sclk_m__0__HSIOM EQU CYREG_HSIOM_PORT_SEL0
SPILCD_sclk_m__0__HSIOM_GPIO EQU 0
SPILCD_sclk_m__0__HSIOM_MASK EQU 0x0F000000
SPILCD_sclk_m__0__HSIOM_SHIFT EQU 24
SPILCD_sclk_m__0__HSIOM_SPI EQU 15
SPILCD_sclk_m__0__HSIOM_SPI_CLK EQU 15
SPILCD_sclk_m__0__INTCFG EQU CYREG_PRT0_INTCFG
SPILCD_sclk_m__0__INTSTAT EQU CYREG_PRT0_INTSTAT
SPILCD_sclk_m__0__MASK EQU 0x40
SPILCD_sclk_m__0__OUT_SEL EQU CYREG_UDB_PA0_CFG10
SPILCD_sclk_m__0__OUT_SEL_SHIFT EQU 12
SPILCD_sclk_m__0__OUT_SEL_VAL EQU -1
SPILCD_sclk_m__0__PA__CFG0 EQU CYREG_UDB_PA0_CFG0
SPILCD_sclk_m__0__PA__CFG1 EQU CYREG_UDB_PA0_CFG1
SPILCD_sclk_m__0__PA__CFG10 EQU CYREG_UDB_PA0_CFG10
SPILCD_sclk_m__0__PA__CFG11 EQU CYREG_UDB_PA0_CFG11
SPILCD_sclk_m__0__PA__CFG12 EQU CYREG_UDB_PA0_CFG12
SPILCD_sclk_m__0__PA__CFG13 EQU CYREG_UDB_PA0_CFG13
SPILCD_sclk_m__0__PA__CFG14 EQU CYREG_UDB_PA0_CFG14
SPILCD_sclk_m__0__PA__CFG2 EQU CYREG_UDB_PA0_CFG2
SPILCD_sclk_m__0__PA__CFG3 EQU CYREG_UDB_PA0_CFG3
SPILCD_sclk_m__0__PA__CFG4 EQU CYREG_UDB_PA0_CFG4
SPILCD_sclk_m__0__PA__CFG5 EQU CYREG_UDB_PA0_CFG5
SPILCD_sclk_m__0__PA__CFG6 EQU CYREG_UDB_PA0_CFG6
SPILCD_sclk_m__0__PA__CFG7 EQU CYREG_UDB_PA0_CFG7
SPILCD_sclk_m__0__PA__CFG8 EQU CYREG_UDB_PA0_CFG8
SPILCD_sclk_m__0__PA__CFG9 EQU CYREG_UDB_PA0_CFG9
SPILCD_sclk_m__0__PC EQU CYREG_PRT0_PC
SPILCD_sclk_m__0__PC2 EQU CYREG_PRT0_PC2
SPILCD_sclk_m__0__PORT EQU 0
SPILCD_sclk_m__0__PS EQU CYREG_PRT0_PS
SPILCD_sclk_m__0__SHIFT EQU 6
SPILCD_sclk_m__DR EQU CYREG_PRT0_DR
SPILCD_sclk_m__INTCFG EQU CYREG_PRT0_INTCFG
SPILCD_sclk_m__INTSTAT EQU CYREG_PRT0_INTSTAT
SPILCD_sclk_m__MASK EQU 0x40
SPILCD_sclk_m__PA__CFG0 EQU CYREG_UDB_PA0_CFG0
SPILCD_sclk_m__PA__CFG1 EQU CYREG_UDB_PA0_CFG1
SPILCD_sclk_m__PA__CFG10 EQU CYREG_UDB_PA0_CFG10
SPILCD_sclk_m__PA__CFG11 EQU CYREG_UDB_PA0_CFG11
SPILCD_sclk_m__PA__CFG12 EQU CYREG_UDB_PA0_CFG12
SPILCD_sclk_m__PA__CFG13 EQU CYREG_UDB_PA0_CFG13
SPILCD_sclk_m__PA__CFG14 EQU CYREG_UDB_PA0_CFG14
SPILCD_sclk_m__PA__CFG2 EQU CYREG_UDB_PA0_CFG2
SPILCD_sclk_m__PA__CFG3 EQU CYREG_UDB_PA0_CFG3
SPILCD_sclk_m__PA__CFG4 EQU CYREG_UDB_PA0_CFG4
SPILCD_sclk_m__PA__CFG5 EQU CYREG_UDB_PA0_CFG5
SPILCD_sclk_m__PA__CFG6 EQU CYREG_UDB_PA0_CFG6
SPILCD_sclk_m__PA__CFG7 EQU CYREG_UDB_PA0_CFG7
SPILCD_sclk_m__PA__CFG8 EQU CYREG_UDB_PA0_CFG8
SPILCD_sclk_m__PA__CFG9 EQU CYREG_UDB_PA0_CFG9
SPILCD_sclk_m__PC EQU CYREG_PRT0_PC
SPILCD_sclk_m__PC2 EQU CYREG_PRT0_PC2
SPILCD_sclk_m__PORT EQU 0
SPILCD_sclk_m__PS EQU CYREG_PRT0_PS
SPILCD_sclk_m__SHIFT EQU 6

; Clock_1
Clock_1__DIVIDER_MASK EQU 0x0000FFFF
Clock_1__ENABLE EQU CYREG_CLK_DIVIDER_A00
Clock_1__ENABLE_MASK EQU 0x80000000
Clock_1__MASK EQU 0x80000000
Clock_1__REGISTER EQU CYREG_CLK_DIVIDER_A00

; ISR_Reset
ISR_Reset__INTC_CLR_EN_REG EQU CYREG_CM0_ICER
ISR_Reset__INTC_CLR_PD_REG EQU CYREG_CM0_ICPR
ISR_Reset__INTC_MASK EQU 0x04
ISR_Reset__INTC_NUMBER EQU 2
ISR_Reset__INTC_PRIOR_MASK EQU 0xC00000
ISR_Reset__INTC_PRIOR_NUM EQU 3
ISR_Reset__INTC_PRIOR_REG EQU CYREG_CM0_IPR0
ISR_Reset__INTC_SET_EN_REG EQU CYREG_CM0_ISER
ISR_Reset__INTC_SET_PD_REG EQU CYREG_CM0_ISPR

; LCD_RESET
LCD_RESET__0__DM__MASK EQU 0x1C0000
LCD_RESET__0__DM__SHIFT EQU 18
LCD_RESET__0__DR EQU CYREG_PRT3_DR
LCD_RESET__0__HSIOM EQU CYREG_HSIOM_PORT_SEL3
LCD_RESET__0__HSIOM_MASK EQU 0x0F000000
LCD_RESET__0__HSIOM_SHIFT EQU 24
LCD_RESET__0__INTCFG EQU CYREG_PRT3_INTCFG
LCD_RESET__0__INTSTAT EQU CYREG_PRT3_INTSTAT
LCD_RESET__0__MASK EQU 0x40
LCD_RESET__0__PA__CFG0 EQU CYREG_UDB_PA3_CFG0
LCD_RESET__0__PA__CFG1 EQU CYREG_UDB_PA3_CFG1
LCD_RESET__0__PA__CFG10 EQU CYREG_UDB_PA3_CFG10
LCD_RESET__0__PA__CFG11 EQU CYREG_UDB_PA3_CFG11
LCD_RESET__0__PA__CFG12 EQU CYREG_UDB_PA3_CFG12
LCD_RESET__0__PA__CFG13 EQU CYREG_UDB_PA3_CFG13
LCD_RESET__0__PA__CFG14 EQU CYREG_UDB_PA3_CFG14
LCD_RESET__0__PA__CFG2 EQU CYREG_UDB_PA3_CFG2
LCD_RESET__0__PA__CFG3 EQU CYREG_UDB_PA3_CFG3
LCD_RESET__0__PA__CFG4 EQU CYREG_UDB_PA3_CFG4
LCD_RESET__0__PA__CFG5 EQU CYREG_UDB_PA3_CFG5
LCD_RESET__0__PA__CFG6 EQU CYREG_UDB_PA3_CFG6
LCD_RESET__0__PA__CFG7 EQU CYREG_UDB_PA3_CFG7
LCD_RESET__0__PA__CFG8 EQU CYREG_UDB_PA3_CFG8
LCD_RESET__0__PA__CFG9 EQU CYREG_UDB_PA3_CFG9
LCD_RESET__0__PC EQU CYREG_PRT3_PC
LCD_RESET__0__PC2 EQU CYREG_PRT3_PC2
LCD_RESET__0__PORT EQU 3
LCD_RESET__0__PS EQU CYREG_PRT3_PS
LCD_RESET__0__SHIFT EQU 6
LCD_RESET__DR EQU CYREG_PRT3_DR
LCD_RESET__INTCFG EQU CYREG_PRT3_INTCFG
LCD_RESET__INTSTAT EQU CYREG_PRT3_INTSTAT
LCD_RESET__MASK EQU 0x40
LCD_RESET__PA__CFG0 EQU CYREG_UDB_PA3_CFG0
LCD_RESET__PA__CFG1 EQU CYREG_UDB_PA3_CFG1
LCD_RESET__PA__CFG10 EQU CYREG_UDB_PA3_CFG10
LCD_RESET__PA__CFG11 EQU CYREG_UDB_PA3_CFG11
LCD_RESET__PA__CFG12 EQU CYREG_UDB_PA3_CFG12
LCD_RESET__PA__CFG13 EQU CYREG_UDB_PA3_CFG13
LCD_RESET__PA__CFG14 EQU CYREG_UDB_PA3_CFG14
LCD_RESET__PA__CFG2 EQU CYREG_UDB_PA3_CFG2
LCD_RESET__PA__CFG3 EQU CYREG_UDB_PA3_CFG3
LCD_RESET__PA__CFG4 EQU CYREG_UDB_PA3_CFG4
LCD_RESET__PA__CFG5 EQU CYREG_UDB_PA3_CFG5
LCD_RESET__PA__CFG6 EQU CYREG_UDB_PA3_CFG6
LCD_RESET__PA__CFG7 EQU CYREG_UDB_PA3_CFG7
LCD_RESET__PA__CFG8 EQU CYREG_UDB_PA3_CFG8
LCD_RESET__PA__CFG9 EQU CYREG_UDB_PA3_CFG9
LCD_RESET__PC EQU CYREG_PRT3_PC
LCD_RESET__PC2 EQU CYREG_PRT3_PC2
LCD_RESET__PORT EQU 3
LCD_RESET__PS EQU CYREG_PRT3_PS
LCD_RESET__SHIFT EQU 6

; IData_Port
IData_Port__0__DM__MASK EQU 0x07
IData_Port__0__DM__SHIFT EQU 0
IData_Port__0__DR EQU CYREG_PRT2_DR
IData_Port__0__HSIOM EQU CYREG_HSIOM_PORT_SEL2
IData_Port__0__HSIOM_MASK EQU 0x0000000F
IData_Port__0__HSIOM_SHIFT EQU 0
IData_Port__0__INTCFG EQU CYREG_PRT2_INTCFG
IData_Port__0__INTSTAT EQU CYREG_PRT2_INTSTAT
IData_Port__0__MASK EQU 0x01
IData_Port__0__PA__CFG0 EQU CYREG_UDB_PA2_CFG0
IData_Port__0__PA__CFG1 EQU CYREG_UDB_PA2_CFG1
IData_Port__0__PA__CFG10 EQU CYREG_UDB_PA2_CFG10
IData_Port__0__PA__CFG11 EQU CYREG_UDB_PA2_CFG11
IData_Port__0__PA__CFG12 EQU CYREG_UDB_PA2_CFG12
IData_Port__0__PA__CFG13 EQU CYREG_UDB_PA2_CFG13
IData_Port__0__PA__CFG14 EQU CYREG_UDB_PA2_CFG14
IData_Port__0__PA__CFG2 EQU CYREG_UDB_PA2_CFG2
IData_Port__0__PA__CFG3 EQU CYREG_UDB_PA2_CFG3
IData_Port__0__PA__CFG4 EQU CYREG_UDB_PA2_CFG4
IData_Port__0__PA__CFG5 EQU CYREG_UDB_PA2_CFG5
IData_Port__0__PA__CFG6 EQU CYREG_UDB_PA2_CFG6
IData_Port__0__PA__CFG7 EQU CYREG_UDB_PA2_CFG7
IData_Port__0__PA__CFG8 EQU CYREG_UDB_PA2_CFG8
IData_Port__0__PA__CFG9 EQU CYREG_UDB_PA2_CFG9
IData_Port__0__PC EQU CYREG_PRT2_PC
IData_Port__0__PC2 EQU CYREG_PRT2_PC2
IData_Port__0__PORT EQU 2
IData_Port__0__PS EQU CYREG_PRT2_PS
IData_Port__0__SHIFT EQU 0
IData_Port__1__DM__MASK EQU 0x38
IData_Port__1__DM__SHIFT EQU 3
IData_Port__1__DR EQU CYREG_PRT2_DR
IData_Port__1__HSIOM EQU CYREG_HSIOM_PORT_SEL2
IData_Port__1__HSIOM_MASK EQU 0x000000F0
IData_Port__1__HSIOM_SHIFT EQU 4
IData_Port__1__INTCFG EQU CYREG_PRT2_INTCFG
IData_Port__1__INTSTAT EQU CYREG_PRT2_INTSTAT
IData_Port__1__MASK EQU 0x02
IData_Port__1__PA__CFG0 EQU CYREG_UDB_PA2_CFG0
IData_Port__1__PA__CFG1 EQU CYREG_UDB_PA2_CFG1
IData_Port__1__PA__CFG10 EQU CYREG_UDB_PA2_CFG10
IData_Port__1__PA__CFG11 EQU CYREG_UDB_PA2_CFG11
IData_Port__1__PA__CFG12 EQU CYREG_UDB_PA2_CFG12
IData_Port__1__PA__CFG13 EQU CYREG_UDB_PA2_CFG13
IData_Port__1__PA__CFG14 EQU CYREG_UDB_PA2_CFG14
IData_Port__1__PA__CFG2 EQU CYREG_UDB_PA2_CFG2
IData_Port__1__PA__CFG3 EQU CYREG_UDB_PA2_CFG3
IData_Port__1__PA__CFG4 EQU CYREG_UDB_PA2_CFG4
IData_Port__1__PA__CFG5 EQU CYREG_UDB_PA2_CFG5
IData_Port__1__PA__CFG6 EQU CYREG_UDB_PA2_CFG6
IData_Port__1__PA__CFG7 EQU CYREG_UDB_PA2_CFG7
IData_Port__1__PA__CFG8 EQU CYREG_UDB_PA2_CFG8
IData_Port__1__PA__CFG9 EQU CYREG_UDB_PA2_CFG9
IData_Port__1__PC EQU CYREG_PRT2_PC
IData_Port__1__PC2 EQU CYREG_PRT2_PC2
IData_Port__1__PORT EQU 2
IData_Port__1__PS EQU CYREG_PRT2_PS
IData_Port__1__SHIFT EQU 1
IData_Port__2__DM__MASK EQU 0x1C0
IData_Port__2__DM__SHIFT EQU 6
IData_Port__2__DR EQU CYREG_PRT2_DR
IData_Port__2__HSIOM EQU CYREG_HSIOM_PORT_SEL2
IData_Port__2__HSIOM_MASK EQU 0x00000F00
IData_Port__2__HSIOM_SHIFT EQU 8
IData_Port__2__INTCFG EQU CYREG_PRT2_INTCFG
IData_Port__2__INTSTAT EQU CYREG_PRT2_INTSTAT
IData_Port__2__MASK EQU 0x04
IData_Port__2__PA__CFG0 EQU CYREG_UDB_PA2_CFG0
IData_Port__2__PA__CFG1 EQU CYREG_UDB_PA2_CFG1
IData_Port__2__PA__CFG10 EQU CYREG_UDB_PA2_CFG10
IData_Port__2__PA__CFG11 EQU CYREG_UDB_PA2_CFG11
IData_Port__2__PA__CFG12 EQU CYREG_UDB_PA2_CFG12
IData_Port__2__PA__CFG13 EQU CYREG_UDB_PA2_CFG13
IData_Port__2__PA__CFG14 EQU CYREG_UDB_PA2_CFG14
IData_Port__2__PA__CFG2 EQU CYREG_UDB_PA2_CFG2
IData_Port__2__PA__CFG3 EQU CYREG_UDB_PA2_CFG3
IData_Port__2__PA__CFG4 EQU CYREG_UDB_PA2_CFG4
IData_Port__2__PA__CFG5 EQU CYREG_UDB_PA2_CFG5
IData_Port__2__PA__CFG6 EQU CYREG_UDB_PA2_CFG6
IData_Port__2__PA__CFG7 EQU CYREG_UDB_PA2_CFG7
IData_Port__2__PA__CFG8 EQU CYREG_UDB_PA2_CFG8
IData_Port__2__PA__CFG9 EQU CYREG_UDB_PA2_CFG9
IData_Port__2__PC EQU CYREG_PRT2_PC
IData_Port__2__PC2 EQU CYREG_PRT2_PC2
IData_Port__2__PORT EQU 2
IData_Port__2__PS EQU CYREG_PRT2_PS
IData_Port__2__SHIFT EQU 2
IData_Port__3__DM__MASK EQU 0xE00
IData_Port__3__DM__SHIFT EQU 9
IData_Port__3__DR EQU CYREG_PRT2_DR
IData_Port__3__HSIOM EQU CYREG_HSIOM_PORT_SEL2
IData_Port__3__HSIOM_MASK EQU 0x0000F000
IData_Port__3__HSIOM_SHIFT EQU 12
IData_Port__3__INTCFG EQU CYREG_PRT2_INTCFG
IData_Port__3__INTSTAT EQU CYREG_PRT2_INTSTAT
IData_Port__3__MASK EQU 0x08
IData_Port__3__PA__CFG0 EQU CYREG_UDB_PA2_CFG0
IData_Port__3__PA__CFG1 EQU CYREG_UDB_PA2_CFG1
IData_Port__3__PA__CFG10 EQU CYREG_UDB_PA2_CFG10
IData_Port__3__PA__CFG11 EQU CYREG_UDB_PA2_CFG11
IData_Port__3__PA__CFG12 EQU CYREG_UDB_PA2_CFG12
IData_Port__3__PA__CFG13 EQU CYREG_UDB_PA2_CFG13
IData_Port__3__PA__CFG14 EQU CYREG_UDB_PA2_CFG14
IData_Port__3__PA__CFG2 EQU CYREG_UDB_PA2_CFG2
IData_Port__3__PA__CFG3 EQU CYREG_UDB_PA2_CFG3
IData_Port__3__PA__CFG4 EQU CYREG_UDB_PA2_CFG4
IData_Port__3__PA__CFG5 EQU CYREG_UDB_PA2_CFG5
IData_Port__3__PA__CFG6 EQU CYREG_UDB_PA2_CFG6
IData_Port__3__PA__CFG7 EQU CYREG_UDB_PA2_CFG7
IData_Port__3__PA__CFG8 EQU CYREG_UDB_PA2_CFG8
IData_Port__3__PA__CFG9 EQU CYREG_UDB_PA2_CFG9
IData_Port__3__PC EQU CYREG_PRT2_PC
IData_Port__3__PC2 EQU CYREG_PRT2_PC2
IData_Port__3__PORT EQU 2
IData_Port__3__PS EQU CYREG_PRT2_PS
IData_Port__3__SHIFT EQU 3
IData_Port__4__DM__MASK EQU 0x7000
IData_Port__4__DM__SHIFT EQU 12
IData_Port__4__DR EQU CYREG_PRT2_DR
IData_Port__4__HSIOM EQU CYREG_HSIOM_PORT_SEL2
IData_Port__4__HSIOM_MASK EQU 0x000F0000
IData_Port__4__HSIOM_SHIFT EQU 16
IData_Port__4__INTCFG EQU CYREG_PRT2_INTCFG
IData_Port__4__INTSTAT EQU CYREG_PRT2_INTSTAT
IData_Port__4__MASK EQU 0x10
IData_Port__4__PA__CFG0 EQU CYREG_UDB_PA2_CFG0
IData_Port__4__PA__CFG1 EQU CYREG_UDB_PA2_CFG1
IData_Port__4__PA__CFG10 EQU CYREG_UDB_PA2_CFG10
IData_Port__4__PA__CFG11 EQU CYREG_UDB_PA2_CFG11
IData_Port__4__PA__CFG12 EQU CYREG_UDB_PA2_CFG12
IData_Port__4__PA__CFG13 EQU CYREG_UDB_PA2_CFG13
IData_Port__4__PA__CFG14 EQU CYREG_UDB_PA2_CFG14
IData_Port__4__PA__CFG2 EQU CYREG_UDB_PA2_CFG2
IData_Port__4__PA__CFG3 EQU CYREG_UDB_PA2_CFG3
IData_Port__4__PA__CFG4 EQU CYREG_UDB_PA2_CFG4
IData_Port__4__PA__CFG5 EQU CYREG_UDB_PA2_CFG5
IData_Port__4__PA__CFG6 EQU CYREG_UDB_PA2_CFG6
IData_Port__4__PA__CFG7 EQU CYREG_UDB_PA2_CFG7
IData_Port__4__PA__CFG8 EQU CYREG_UDB_PA2_CFG8
IData_Port__4__PA__CFG9 EQU CYREG_UDB_PA2_CFG9
IData_Port__4__PC EQU CYREG_PRT2_PC
IData_Port__4__PC2 EQU CYREG_PRT2_PC2
IData_Port__4__PORT EQU 2
IData_Port__4__PS EQU CYREG_PRT2_PS
IData_Port__4__SHIFT EQU 4
IData_Port__5__DM__MASK EQU 0x38000
IData_Port__5__DM__SHIFT EQU 15
IData_Port__5__DR EQU CYREG_PRT2_DR
IData_Port__5__HSIOM EQU CYREG_HSIOM_PORT_SEL2
IData_Port__5__HSIOM_MASK EQU 0x00F00000
IData_Port__5__HSIOM_SHIFT EQU 20
IData_Port__5__INTCFG EQU CYREG_PRT2_INTCFG
IData_Port__5__INTSTAT EQU CYREG_PRT2_INTSTAT
IData_Port__5__MASK EQU 0x20
IData_Port__5__PA__CFG0 EQU CYREG_UDB_PA2_CFG0
IData_Port__5__PA__CFG1 EQU CYREG_UDB_PA2_CFG1
IData_Port__5__PA__CFG10 EQU CYREG_UDB_PA2_CFG10
IData_Port__5__PA__CFG11 EQU CYREG_UDB_PA2_CFG11
IData_Port__5__PA__CFG12 EQU CYREG_UDB_PA2_CFG12
IData_Port__5__PA__CFG13 EQU CYREG_UDB_PA2_CFG13
IData_Port__5__PA__CFG14 EQU CYREG_UDB_PA2_CFG14
IData_Port__5__PA__CFG2 EQU CYREG_UDB_PA2_CFG2
IData_Port__5__PA__CFG3 EQU CYREG_UDB_PA2_CFG3
IData_Port__5__PA__CFG4 EQU CYREG_UDB_PA2_CFG4
IData_Port__5__PA__CFG5 EQU CYREG_UDB_PA2_CFG5
IData_Port__5__PA__CFG6 EQU CYREG_UDB_PA2_CFG6
IData_Port__5__PA__CFG7 EQU CYREG_UDB_PA2_CFG7
IData_Port__5__PA__CFG8 EQU CYREG_UDB_PA2_CFG8
IData_Port__5__PA__CFG9 EQU CYREG_UDB_PA2_CFG9
IData_Port__5__PC EQU CYREG_PRT2_PC
IData_Port__5__PC2 EQU CYREG_PRT2_PC2
IData_Port__5__PORT EQU 2
IData_Port__5__PS EQU CYREG_PRT2_PS
IData_Port__5__SHIFT EQU 5
IData_Port__6__DM__MASK EQU 0x1C0000
IData_Port__6__DM__SHIFT EQU 18
IData_Port__6__DR EQU CYREG_PRT2_DR
IData_Port__6__HSIOM EQU CYREG_HSIOM_PORT_SEL2
IData_Port__6__HSIOM_MASK EQU 0x0F000000
IData_Port__6__HSIOM_SHIFT EQU 24
IData_Port__6__INTCFG EQU CYREG_PRT2_INTCFG
IData_Port__6__INTSTAT EQU CYREG_PRT2_INTSTAT
IData_Port__6__MASK EQU 0x40
IData_Port__6__PA__CFG0 EQU CYREG_UDB_PA2_CFG0
IData_Port__6__PA__CFG1 EQU CYREG_UDB_PA2_CFG1
IData_Port__6__PA__CFG10 EQU CYREG_UDB_PA2_CFG10
IData_Port__6__PA__CFG11 EQU CYREG_UDB_PA2_CFG11
IData_Port__6__PA__CFG12 EQU CYREG_UDB_PA2_CFG12
IData_Port__6__PA__CFG13 EQU CYREG_UDB_PA2_CFG13
IData_Port__6__PA__CFG14 EQU CYREG_UDB_PA2_CFG14
IData_Port__6__PA__CFG2 EQU CYREG_UDB_PA2_CFG2
IData_Port__6__PA__CFG3 EQU CYREG_UDB_PA2_CFG3
IData_Port__6__PA__CFG4 EQU CYREG_UDB_PA2_CFG4
IData_Port__6__PA__CFG5 EQU CYREG_UDB_PA2_CFG5
IData_Port__6__PA__CFG6 EQU CYREG_UDB_PA2_CFG6
IData_Port__6__PA__CFG7 EQU CYREG_UDB_PA2_CFG7
IData_Port__6__PA__CFG8 EQU CYREG_UDB_PA2_CFG8
IData_Port__6__PA__CFG9 EQU CYREG_UDB_PA2_CFG9
IData_Port__6__PC EQU CYREG_PRT2_PC
IData_Port__6__PC2 EQU CYREG_PRT2_PC2
IData_Port__6__PORT EQU 2
IData_Port__6__PS EQU CYREG_PRT2_PS
IData_Port__6__SHIFT EQU 6
IData_Port__7__DM__MASK EQU 0xE00000
IData_Port__7__DM__SHIFT EQU 21
IData_Port__7__DR EQU CYREG_PRT2_DR
IData_Port__7__HSIOM EQU CYREG_HSIOM_PORT_SEL2
IData_Port__7__HSIOM_MASK EQU 0xF0000000
IData_Port__7__HSIOM_SHIFT EQU 28
IData_Port__7__INTCFG EQU CYREG_PRT2_INTCFG
IData_Port__7__INTSTAT EQU CYREG_PRT2_INTSTAT
IData_Port__7__MASK EQU 0x80
IData_Port__7__PA__CFG0 EQU CYREG_UDB_PA2_CFG0
IData_Port__7__PA__CFG1 EQU CYREG_UDB_PA2_CFG1
IData_Port__7__PA__CFG10 EQU CYREG_UDB_PA2_CFG10
IData_Port__7__PA__CFG11 EQU CYREG_UDB_PA2_CFG11
IData_Port__7__PA__CFG12 EQU CYREG_UDB_PA2_CFG12
IData_Port__7__PA__CFG13 EQU CYREG_UDB_PA2_CFG13
IData_Port__7__PA__CFG14 EQU CYREG_UDB_PA2_CFG14
IData_Port__7__PA__CFG2 EQU CYREG_UDB_PA2_CFG2
IData_Port__7__PA__CFG3 EQU CYREG_UDB_PA2_CFG3
IData_Port__7__PA__CFG4 EQU CYREG_UDB_PA2_CFG4
IData_Port__7__PA__CFG5 EQU CYREG_UDB_PA2_CFG5
IData_Port__7__PA__CFG6 EQU CYREG_UDB_PA2_CFG6
IData_Port__7__PA__CFG7 EQU CYREG_UDB_PA2_CFG7
IData_Port__7__PA__CFG8 EQU CYREG_UDB_PA2_CFG8
IData_Port__7__PA__CFG9 EQU CYREG_UDB_PA2_CFG9
IData_Port__7__PC EQU CYREG_PRT2_PC
IData_Port__7__PC2 EQU CYREG_PRT2_PC2
IData_Port__7__PORT EQU 2
IData_Port__7__PS EQU CYREG_PRT2_PS
IData_Port__7__SHIFT EQU 7
IData_Port__DR EQU CYREG_PRT2_DR
IData_Port__INTCFG EQU CYREG_PRT2_INTCFG
IData_Port__INTSTAT EQU CYREG_PRT2_INTSTAT
IData_Port__MASK EQU 0xFF
IData_Port__PA__CFG0 EQU CYREG_UDB_PA2_CFG0
IData_Port__PA__CFG1 EQU CYREG_UDB_PA2_CFG1
IData_Port__PA__CFG10 EQU CYREG_UDB_PA2_CFG10
IData_Port__PA__CFG11 EQU CYREG_UDB_PA2_CFG11
IData_Port__PA__CFG12 EQU CYREG_UDB_PA2_CFG12
IData_Port__PA__CFG13 EQU CYREG_UDB_PA2_CFG13
IData_Port__PA__CFG14 EQU CYREG_UDB_PA2_CFG14
IData_Port__PA__CFG2 EQU CYREG_UDB_PA2_CFG2
IData_Port__PA__CFG3 EQU CYREG_UDB_PA2_CFG3
IData_Port__PA__CFG4 EQU CYREG_UDB_PA2_CFG4
IData_Port__PA__CFG5 EQU CYREG_UDB_PA2_CFG5
IData_Port__PA__CFG6 EQU CYREG_UDB_PA2_CFG6
IData_Port__PA__CFG7 EQU CYREG_UDB_PA2_CFG7
IData_Port__PA__CFG8 EQU CYREG_UDB_PA2_CFG8
IData_Port__PA__CFG9 EQU CYREG_UDB_PA2_CFG9
IData_Port__PC EQU CYREG_PRT2_PC
IData_Port__PC2 EQU CYREG_PRT2_PC2
IData_Port__PORT EQU 2
IData_Port__PS EQU CYREG_PRT2_PS
IData_Port__SHIFT EQU 0

; ISR_Capture
ISR_Capture__INTC_CLR_EN_REG EQU CYREG_CM0_ICER
ISR_Capture__INTC_CLR_PD_REG EQU CYREG_CM0_ICPR
ISR_Capture__INTC_MASK EQU 0x01
ISR_Capture__INTC_NUMBER EQU 0
ISR_Capture__INTC_PRIOR_MASK EQU 0xC0
ISR_Capture__INTC_PRIOR_NUM EQU 3
ISR_Capture__INTC_PRIOR_REG EQU CYREG_CM0_IPR0
ISR_Capture__INTC_SET_EN_REG EQU CYREG_CM0_ISER
ISR_Capture__INTC_SET_PD_REG EQU CYREG_CM0_ISPR

; Miscellaneous
CYDEV_BCLK__HFCLK__HZ EQU 48000000
CYDEV_BCLK__HFCLK__KHZ EQU 48000
CYDEV_BCLK__HFCLK__MHZ EQU 48
CYDEV_BCLK__SYSCLK__HZ EQU 48000000
CYDEV_BCLK__SYSCLK__KHZ EQU 48000
CYDEV_BCLK__SYSCLK__MHZ EQU 48
CYDEV_CHIP_DIE_LEOPARD EQU 1
CYDEV_CHIP_DIE_PSOC4A EQU 24
CYDEV_CHIP_DIE_PSOC5LP EQU 2
CYDEV_CHIP_DIE_PSOC5TM EQU 3
CYDEV_CHIP_DIE_TMA4 EQU 4
CYDEV_CHIP_DIE_UNKNOWN EQU 0
CYDEV_CHIP_FAMILY_FM0P EQU 5
CYDEV_CHIP_FAMILY_FM3 EQU 6
CYDEV_CHIP_FAMILY_FM4 EQU 7
CYDEV_CHIP_FAMILY_PSOC3 EQU 1
CYDEV_CHIP_FAMILY_PSOC4 EQU 2
CYDEV_CHIP_FAMILY_PSOC5 EQU 3
CYDEV_CHIP_FAMILY_PSOC6 EQU 4
CYDEV_CHIP_FAMILY_UNKNOWN EQU 0
CYDEV_CHIP_FAMILY_USED EQU CYDEV_CHIP_FAMILY_PSOC4
CYDEV_CHIP_JTAG_ID EQU 0x04C81193
CYDEV_CHIP_MEMBER_3A EQU 1
CYDEV_CHIP_MEMBER_4A EQU 24
CYDEV_CHIP_MEMBER_4AA EQU 23
CYDEV_CHIP_MEMBER_4AB EQU 28
CYDEV_CHIP_MEMBER_4AC EQU 14
CYDEV_CHIP_MEMBER_4D EQU 18
CYDEV_CHIP_MEMBER_4E EQU 6
CYDEV_CHIP_MEMBER_4F EQU 25
CYDEV_CHIP_MEMBER_4G EQU 4
CYDEV_CHIP_MEMBER_4H EQU 22
CYDEV_CHIP_MEMBER_4I EQU 30
CYDEV_CHIP_MEMBER_4J EQU 19
CYDEV_CHIP_MEMBER_4K EQU 20
CYDEV_CHIP_MEMBER_4L EQU 29
CYDEV_CHIP_MEMBER_4M EQU 27
CYDEV_CHIP_MEMBER_4N EQU 11
CYDEV_CHIP_MEMBER_4O EQU 8
CYDEV_CHIP_MEMBER_4P EQU 26
CYDEV_CHIP_MEMBER_4Q EQU 15
CYDEV_CHIP_MEMBER_4R EQU 9
CYDEV_CHIP_MEMBER_4S EQU 12
CYDEV_CHIP_MEMBER_4T EQU 10
CYDEV_CHIP_MEMBER_4U EQU 5
CYDEV_CHIP_MEMBER_4V EQU 21
CYDEV_CHIP_MEMBER_4W EQU 13
CYDEV_CHIP_MEMBER_4X EQU 7
CYDEV_CHIP_MEMBER_4Y EQU 16
CYDEV_CHIP_MEMBER_4Z EQU 17
CYDEV_CHIP_MEMBER_5A EQU 3
CYDEV_CHIP_MEMBER_5B EQU 2
CYDEV_CHIP_MEMBER_6A EQU 31
CYDEV_CHIP_MEMBER_FM3 EQU 35
CYDEV_CHIP_MEMBER_FM4 EQU 36
CYDEV_CHIP_MEMBER_PDL_FM0P_TYPE1 EQU 32
CYDEV_CHIP_MEMBER_PDL_FM0P_TYPE2 EQU 33
CYDEV_CHIP_MEMBER_PDL_FM0P_TYPE3 EQU 34
CYDEV_CHIP_MEMBER_UNKNOWN EQU 0
CYDEV_CHIP_MEMBER_USED EQU CYDEV_CHIP_MEMBER_4A
CYDEV_CHIP_DIE_EXPECT EQU CYDEV_CHIP_MEMBER_USED
CYDEV_CHIP_DIE_ACTUAL EQU CYDEV_CHIP_DIE_EXPECT
CYDEV_CHIP_REV_LEOPARD_ES1 EQU 0
CYDEV_CHIP_REV_LEOPARD_ES2 EQU 1
CYDEV_CHIP_REV_LEOPARD_ES3 EQU 3
CYDEV_CHIP_REV_LEOPARD_PRODUCTION EQU 3
CYDEV_CHIP_REV_PSOC4A_ES0 EQU 17
CYDEV_CHIP_REV_PSOC4A_PRODUCTION EQU 17
CYDEV_CHIP_REV_PSOC5LP_ES0 EQU 0
CYDEV_CHIP_REV_PSOC5LP_PRODUCTION EQU 0
CYDEV_CHIP_REV_PSOC5TM_ES0 EQU 0
CYDEV_CHIP_REV_PSOC5TM_ES1 EQU 1
CYDEV_CHIP_REV_PSOC5TM_PRODUCTION EQU 1
CYDEV_CHIP_REV_TMA4_ES EQU 17
CYDEV_CHIP_REV_TMA4_ES2 EQU 33
CYDEV_CHIP_REV_TMA4_PRODUCTION EQU 17
CYDEV_CHIP_REVISION_3A_ES1 EQU 0
CYDEV_CHIP_REVISION_3A_ES2 EQU 1
CYDEV_CHIP_REVISION_3A_ES3 EQU 3
CYDEV_CHIP_REVISION_3A_PRODUCTION EQU 3
CYDEV_CHIP_REVISION_4A_ES0 EQU 17
CYDEV_CHIP_REVISION_4A_PRODUCTION EQU 17
CYDEV_CHIP_REVISION_4AA_PRODUCTION EQU 0
CYDEV_CHIP_REVISION_4AB_PRODUCTION EQU 0
CYDEV_CHIP_REVISION_4AC_PRODUCTION EQU 0
CYDEV_CHIP_REVISION_4D_PRODUCTION EQU 0
CYDEV_CHIP_REVISION_4E_CCG2_NO_USBPD EQU 0
CYDEV_CHIP_REVISION_4E_PRODUCTION EQU 0
CYDEV_CHIP_REVISION_4F_PRODUCTION EQU 0
CYDEV_CHIP_REVISION_4F_PRODUCTION_256DMA EQU 0
CYDEV_CHIP_REVISION_4F_PRODUCTION_256K EQU 0
CYDEV_CHIP_REVISION_4G_ES EQU 17
CYDEV_CHIP_REVISION_4G_ES2 EQU 33
CYDEV_CHIP_REVISION_4G_PRODUCTION EQU 17
CYDEV_CHIP_REVISION_4H_PRODUCTION EQU 0
CYDEV_CHIP_REVISION_4I_PRODUCTION EQU 0
CYDEV_CHIP_REVISION_4J_PRODUCTION EQU 0
CYDEV_CHIP_REVISION_4K_PRODUCTION EQU 0
CYDEV_CHIP_REVISION_4L_PRODUCTION EQU 0
CYDEV_CHIP_REVISION_4M_PRODUCTION EQU 0
CYDEV_CHIP_REVISION_4N_PRODUCTION EQU 0
CYDEV_CHIP_REVISION_4O_PRODUCTION EQU 0
CYDEV_CHIP_REVISION_4P_PRODUCTION EQU 0
CYDEV_CHIP_REVISION_4Q_PRODUCTION EQU 0
CYDEV_CHIP_REVISION_4R_PRODUCTION EQU 0
CYDEV_CHIP_REVISION_4S_PRODUCTION EQU 0
CYDEV_CHIP_REVISION_4T_PRODUCTION EQU 0
CYDEV_CHIP_REVISION_4U_PRODUCTION EQU 0
CYDEV_CHIP_REVISION_4V_PRODUCTION EQU 0
CYDEV_CHIP_REVISION_4W_PRODUCTION EQU 0
CYDEV_CHIP_REVISION_4X_PRODUCTION EQU 0
CYDEV_CHIP_REVISION_4Y_PRODUCTION EQU 0
CYDEV_CHIP_REVISION_4Z_PRODUCTION EQU 0
CYDEV_CHIP_REVISION_5A_ES0 EQU 0
CYDEV_CHIP_REVISION_5A_ES1 EQU 1
CYDEV_CHIP_REVISION_5A_PRODUCTION EQU 1
CYDEV_CHIP_REVISION_5B_ES0 EQU 0
CYDEV_CHIP_REVISION_5B_PRODUCTION EQU 0
CYDEV_CHIP_REVISION_6A_ES EQU 17
CYDEV_CHIP_REVISION_6A_NO_UDB EQU 33
CYDEV_CHIP_REVISION_6A_PRODUCTION EQU 33
CYDEV_CHIP_REVISION_FM3_PRODUCTION EQU 0
CYDEV_CHIP_REVISION_FM4_PRODUCTION EQU 0
CYDEV_CHIP_REVISION_PDL_FM0P_TYPE1_PRODUCTION EQU 0
CYDEV_CHIP_REVISION_PDL_FM0P_TYPE2_PRODUCTION EQU 0
CYDEV_CHIP_REVISION_PDL_FM0P_TYPE3_PRODUCTION EQU 0
CYDEV_CHIP_REVISION_USED EQU CYDEV_CHIP_REVISION_4A_PRODUCTION
CYDEV_CHIP_REV_EXPECT EQU CYDEV_CHIP_REVISION_USED
CYDEV_CONFIG_READ_ACCELERATOR EQU 1
CYDEV_CONFIG_UNUSED_IO_AllowButWarn EQU 0
CYDEV_CONFIG_UNUSED_IO_AllowWithInfo EQU 1
CYDEV_CONFIG_UNUSED_IO_Disallowed EQU 2
CYDEV_CONFIG_UNUSED_IO EQU CYDEV_CONFIG_UNUSED_IO_Disallowed
CYDEV_CONFIGURATION_COMPRESSED EQU 1
CYDEV_CONFIGURATION_MODE_COMPRESSED EQU 0
CYDEV_CONFIGURATION_MODE EQU CYDEV_CONFIGURATION_MODE_COMPRESSED
CYDEV_CONFIGURATION_MODE_DMA EQU 2
CYDEV_CONFIGURATION_MODE_UNCOMPRESSED EQU 1
CYDEV_DEBUG_PROTECT_KILL EQU 4
CYDEV_DEBUG_PROTECT_OPEN EQU 1
CYDEV_DEBUG_PROTECT EQU CYDEV_DEBUG_PROTECT_OPEN
CYDEV_DEBUG_PROTECT_PROTECTED EQU 2
CYDEV_DEBUGGING_DPS_Disable EQU 3
CYDEV_DEBUGGING_DPS_SWD EQU 2
CYDEV_DEBUGGING_DPS EQU CYDEV_DEBUGGING_DPS_SWD
CYDEV_DEBUGGING_ENABLE EQU 1
CYDEV_DFT_SELECT_CLK0 EQU 1
CYDEV_DFT_SELECT_CLK1 EQU 2
CYDEV_HEAP_SIZE EQU 0x80
CYDEV_IMO_TRIMMED_BY_USB EQU 0
CYDEV_IMO_TRIMMED_BY_WCO EQU 0
CYDEV_IS_EXPORTING_CODE EQU 0
CYDEV_IS_IMPORTING_CODE EQU 0
CYDEV_PROJ_TYPE EQU 0
CYDEV_PROJ_TYPE_BOOTLOADER EQU 1
CYDEV_PROJ_TYPE_LAUNCHER EQU 5
CYDEV_PROJ_TYPE_LOADABLE EQU 2
CYDEV_PROJ_TYPE_LOADABLEANDBOOTLOADER EQU 4
CYDEV_PROJ_TYPE_MULTIAPPBOOTLOADER EQU 3
CYDEV_PROJ_TYPE_STANDARD EQU 0
CYDEV_STACK_SIZE EQU 0x0400
CYDEV_USE_BUNDLED_CMSIS EQU 1
CYDEV_VARIABLE_VDDA EQU 0
CYDEV_VDDA EQU 5
CYDEV_VDDA_MV EQU 5000
CYDEV_VDDD EQU 5
CYDEV_VDDD_MV EQU 5000
CYDEV_WDT_GENERATE_ISR EQU 1
CYIPBLOCK_M0S8_CTBM_VERSION EQU 0
CYIPBLOCK_m0s8cpuss_VERSION EQU 0
CYIPBLOCK_m0s8csd_VERSION EQU 0
CYIPBLOCK_m0s8gpio2_VERSION EQU 0
CYIPBLOCK_m0s8hsiom4a_VERSION EQU 0
CYIPBLOCK_m0s8lcd_VERSION EQU 0
CYIPBLOCK_m0s8lpcomp_VERSION EQU 0
CYIPBLOCK_m0s8pclk_VERSION EQU 0
CYIPBLOCK_m0s8sar_VERSION EQU 0
CYIPBLOCK_m0s8scb_VERSION EQU 0
CYIPBLOCK_m0s8srssv2_VERSION EQU 1
CYIPBLOCK_m0s8tcpwm_VERSION EQU 0
CYIPBLOCK_m0s8udbif_VERSION EQU 0
CYIPBLOCK_S8_GPIO_VERSION EQU 2
CYDEV_BOOTLOADER_ENABLE EQU 0
    ENDIF
    END
